## CMakeLists.txt
```
cmake_minimum_required(VERSION 3.20.0)
find_package(Zephyr REQUIRED HINTS $ENV{ZEPHYR_BASE})
project(lab7_telemetry)

target_sources(app PRIVATE src/main.c src/reading.c src/env_temp.c src/valve.c src/coaps_client.c
			   src/health.c src/dtls_stats.c)
# dtls_stats.c counts failed handshakes by wrapping the Mbed TLS call
target_link_options(app PUBLIC -Wl,--wrap=mbedtls_ssl_handshake)

# Collect the CoAP resources of the "soilsense" service into one list
zephyr_linker_sources(DATA_SECTIONS sections-ram.ld)
zephyr_iterable_section(NAME coap_resource_soilsense GROUP DATA_REGION ${XIP_ALIGN_WITH_INPUT})
```

## Kconfig
```
# BMP280: measure on request and sleep in between, instead of sampling
# continuously. Declared before Kconfig.zephyr so this default comes first.
choice BME280_MODE
	default BME280_MODE_FORCED
endchoice

config LAB_PSK
	string "DTLS pre-shared key"
	default "soilsense-lab-6"
	help
	  The key every client must hold. Hardcoded for the lab; Lab 8 moves it
	  out of the repository.

config LAB_PSK_ID
	string "DTLS PSK identity"
	default "soilsense-pilot"

config LAB_HEALTH_PERIOD_S
	int "Seconds between /sys/health notifications"
	default 60

source "Kconfig.zephyr"
```

## prj.conf
```kconfig
CONFIG_LOG=y
CONFIG_MAIN_STACK_SIZE=4096
CONFIG_CBPRINTF_FP_SUPPORT=y

# Networking over 802.15.4 (Interface Capability)
CONFIG_NETWORKING=y
CONFIG_NET_L2_OPENTHREAD=y
CONFIG_NET_UDP=y
# Without this every board in the room auto-joins the same default network on
# channel 11 at boot.
CONFIG_OPENTHREAD_MANUAL_START=y
CONFIG_OPENTHREAD_PING_SENDER=y
# Lab 5: build a global address from the prefix a Border Router advertises.
CONFIG_OPENTHREAD_SLAAC=y
# The 0 dBm default barely reaches past a few centimetres on these boards.
CONFIG_OPENTHREAD_DEFAULT_TX_POWER=20

# Settings backend for the Thread dataset
CONFIG_NVS=y

# OpenThread CLI as "ot <command>", including the "ot coap" client
CONFIG_SHELL=y
CONFIG_NET_SHELL=y
CONFIG_OPENTHREAD_SHELL=y
CONFIG_OPENTHREAD_COAP=y
CONFIG_OPENTHREAD_COAP_OBSERVE=y
# "ot dataset set active <hex>" is ~240 characters; the defaults truncate a paste.
CONFIG_SHELL_CMD_BUFF_SIZE=512
CONFIG_SHELL_BACKEND_SERIAL_RX_RING_BUFFER_SIZE=512
CONFIG_OPENTHREAD_MAC_FILTER=y

# CoAP server: /env/temp and /act/valve, over DTLS on UDP 5684 (CoAPS)
CONFIG_COAP=y
CONFIG_COAP_SERVER=y
CONFIG_COAP_SERVICE_OBSERVERS=4

# CBOR payloads; canonical = definite-length maps (A1, not BF ... FF)
CONFIG_ZCBOR=y
CONFIG_ZCBOR_CANONICAL=y

# Sensor drivers; the overlay in sensors/ picks the one that is built
CONFIG_SENSOR=y
CONFIG_I2C=y
CONFIG_W1=y

# RGB LED: Thread role, or white while the valve is open
CONFIG_LED_STRIP=y

# DTLS 1.2 with a pre-shared key, TLS_PSK_WITH_AES_128_CCM_8. OpenThread's
# default security profile locks the Mbed TLS options, so the custom profile
# repeats what OpenThread needs and adds DTLS and PSK.
CONFIG_OPENTHREAD_SECURITY_CUSTOM_CONFIG=y
CONFIG_MBEDTLS=y
CONFIG_MBEDTLS_ENABLE_HEAP=y
CONFIG_MBEDTLS_MD_C=y
CONFIG_MBEDTLS_ASN1_PARSE_C=y
CONFIG_SECURE_STORAGE=y
CONFIG_PSA_WANT_KEY_TYPE_AES=y
CONFIG_PSA_WANT_KEY_TYPE_HMAC=y
CONFIG_PSA_WANT_ALG_ECB_NO_PADDING=y
CONFIG_PSA_WANT_ALG_HMAC=y
CONFIG_PSA_WANT_ALG_CCM=y
CONFIG_PSA_WANT_ALG_CMAC=y
CONFIG_PSA_WANT_ALG_SHA_256=y
CONFIG_MBEDTLS_SSL_PROTO_TLS1_2=y
CONFIG_MBEDTLS_SSL_PROTO_DTLS=y
CONFIG_MBEDTLS_KEY_EXCHANGE_PSK_ENABLED=y
CONFIG_PSA_WANT_ALG_TLS12_PRF=y
CONFIG_PSA_WANT_ALG_TLS12_PSK_TO_MS=y
CONFIG_PSA_WANT_KEY_TYPE_DERIVE=y
CONFIG_MBEDTLS_SSL_IN_CONTENT_LEN=1024
CONFIG_MBEDTLS_SSL_OUT_CONTENT_LEN=1024
CONFIG_MBEDTLS_HEAP_SIZE=32768

CONFIG_TLS_CREDENTIALS=y
CONFIG_NET_SOCKETS_SOCKOPT_TLS=y
CONFIG_NET_SOCKETS_ENABLE_DTLS=y
# Two DTLS sockets: the server and the "coaps" shell client. The server keeps
# a session per client (the shell on another board, a laptop, a bridge).
CONFIG_NET_SOCKETS_TLS_MAX_CONTEXTS=2
CONFIG_NET_SOCKETS_TLS_MAX_SESSION_CONTEXTS=4
# A session survives 2 min of client silence: longer than the 45 s Observe
# heartbeat, whose ACK keeps an observer's session alive.
CONFIG_NET_SOCKETS_DTLS_TIMEOUT=120000

# The "coaps" shell client runs the DTLS handshake on the shell thread
CONFIG_SHELL_STACK_SIZE=8192
```

## src/main.c
```c
#include <zephyr/kernel.h>
#include <zephyr/logging/log.h>
#include <zephyr/drivers/led_strip.h>
#include <zephyr/net/coap_service.h>
#include <zephyr/net/tls_credentials.h>
#include <openthread.h>
#include <openthread/thread.h>

#include "app.h"

LOG_MODULE_REGISTER(lab7_telemetry, LOG_LEVEL_INF);

#define PSK_TAG 1

static uint16_t coaps_port = 5684;
static const sec_tag_t sec_tags[] = { PSK_TAG };

/* Started from main() once the PSK is registered. On the board where you run
 * "ot coaps start", OpenThread binds port 5684 itself and keeps the traffic,
 * so that board acts as the client and this server stays silent.
 */
COAPS_SERVICE_DEFINE(soilsense, NULL, &coaps_port, 0, sec_tags, sizeof(sec_tags));

static const struct device *const strip = DEVICE_DT_GET(DT_ALIAS(led_strip));

/* Thread role → LED colour, indexed by otDeviceRole */
static const struct led_rgb role_colors[] = {
	[OT_DEVICE_ROLE_DISABLED] = { .r = 0x00, .g = 0x00, .b = 0x00 },
	[OT_DEVICE_ROLE_DETACHED] = { .r = 0x20, .g = 0x00, .b = 0x00 },
	[OT_DEVICE_ROLE_CHILD]    = { .r = 0x20, .g = 0x18, .b = 0x00 },
	[OT_DEVICE_ROLE_ROUTER]   = { .r = 0x00, .g = 0x20, .b = 0x00 },
	[OT_DEVICE_ROLE_LEADER]   = { .r = 0x00, .g = 0x00, .b = 0x20 },
};
static const struct led_rgb valve_open_color = { .r = 0x30, .g = 0x30, .b = 0x30 };

static atomic_t role = ATOMIC_INIT(OT_DEVICE_ROLE_DISABLED);
static atomic_t valve_open;

/* The OpenThread callback runs with the stack locked; drive the LED from the system workqueue */
static void led_work_handler(struct k_work *work)
{
	struct led_rgb pixel = atomic_get(&valve_open) ? valve_open_color
						       : role_colors[atomic_get(&role)];

	if (led_strip_update_rgb(strip, &pixel, 1) != 0) {
		LOG_ERR("Failed to drive LED");
	}
}

static K_WORK_DEFINE(led_work, led_work_handler);

void led_show_valve(bool open)
{
	atomic_set(&valve_open, open);
	k_work_submit(&led_work);
}

static void ot_state_changed(otChangedFlags flags, void *user_data)
{
	if (!(flags & OT_CHANGED_THREAD_ROLE)) {
		return;
	}

	otDeviceRole r = otThreadGetDeviceRole(openthread_get_default_instance());

	LOG_INF("Thread role: %s", otThreadDeviceRoleToString(r));
	atomic_set(&role, r);
	k_work_submit(&led_work);
}

static struct openthread_state_changed_callback ot_state_cb = {
	.otCallback = ot_state_changed,
};

int response_init(struct coap_packet *rsp, uint8_t *buf, size_t size,
		  const struct coap_packet *req, uint8_t code)
{
	uint8_t token[COAP_TOKEN_MAX_LEN];
	uint8_t tkl = coap_header_get_token(req, token);
	bool con = coap_header_get_type(req) == COAP_TYPE_CON;

	return coap_packet_init(rsp, buf, size, COAP_VERSION_1,
				con ? COAP_TYPE_ACK : COAP_TYPE_NON_CON, tkl, token, code,
				con ? coap_header_get_id(req) : coap_next_id());
}

const char *peer_str(const struct net_sockaddr *addr, char *buf, size_t size)
{
	return net_addr_ntop(NET_AF_INET6, &net_sin6(addr)->sin6_addr, buf, size);
}

static int psk_register(void)
{
	int r = tls_credential_add(PSK_TAG, TLS_CREDENTIAL_PSK, CONFIG_LAB_PSK,
				   strlen(CONFIG_LAB_PSK));

	if (r == 0) {
		r = tls_credential_add(PSK_TAG, TLS_CREDENTIAL_PSK_ID, CONFIG_LAB_PSK_ID,
				       strlen(CONFIG_LAB_PSK_ID));
	}

	return r;
}

int main(void)
{
	int r = psk_register();

	if (r == 0) {
		r = coap_service_start(&soilsense);
	}
	if (r < 0) {
		LOG_ERR("CoAPS server not started (%d)", r);
	}

	if (!device_is_ready(strip)) {
		LOG_ERR("LED strip device not ready");
	} else {
		k_work_submit(&led_work);
		openthread_state_changed_callback_register(&ot_state_cb);
	}

	LOG_INF("SoilSense node ready: CoAPS /env/temp (%s), /act/valve and /sys/health on UDP %u, "
		"PSK identity \"%s\". OpenThread commands start with \"ot\".",
		reading_sensor_name(), coaps_port, CONFIG_LAB_PSK_ID);

	return 0;
}
```

## src/app.h
```c
#ifndef APP_H_
#define APP_H_

#include <stdbool.h>
#include <stdint.h>
#include <zephyr/net/coap.h>

void led_show_valve(bool open);

/* Start a response to req: piggybacked ACK for a CON request, NON otherwise */
int response_init(struct coap_packet *rsp, uint8_t *buf, size_t size,
		  const struct coap_packet *req, uint8_t code);

/* Peer address as text, for logs */
const char *peer_str(const struct net_sockaddr *addr, char *buf, size_t size);

/* Last reading that passed the plausibility checks */
struct reading {
	bool valid;     /* false until the first accepted reading */
	float t;        /* °C */
	int64_t at_ms;  /* uptime when it was taken */
	uint32_t seq;   /* increments with every accepted reading */
};

struct reading reading_get(void);

/* Name of the sensor in the devicetree, or "simulated" */
const char *reading_sensor_name(void);

/* Failed DTLS handshakes since boot (dtls_stats.c) */
uint32_t dtls_handshakes_failed(void);

#endif
```

## src/dtls_stats.c
```c
/* Counts failed DTLS handshakes, for /sys/health. Zephyr's socket layer frees a
 * failed session without telling the CoAP server, so the count comes from
 * wrapping Mbed TLS's handshake step (-Wl,--wrap=mbedtls_ssl_handshake): a
 * wrong key, for one, ends in a timeout once the server gives up waiting.
 */
#include <zephyr/kernel.h>
#include <zephyr/logging/log.h>
#include <mbedtls/ssl.h>

#include "app.h"

LOG_MODULE_REGISTER(dtls_stats, LOG_LEVEL_INF);

static atomic_t failed;

int __real_mbedtls_ssl_handshake(mbedtls_ssl_context *ssl);

int __wrap_mbedtls_ssl_handshake(mbedtls_ssl_context *ssl)
{
	int r = __real_mbedtls_ssl_handshake(ssl);

	switch (r) {
	case 0:
	case MBEDTLS_ERR_SSL_WANT_READ:
	case MBEDTLS_ERR_SSL_WANT_WRITE:
	case MBEDTLS_ERR_SSL_HELLO_VERIFY_REQUIRED:
		break;
	default:
		atomic_inc(&failed);
		LOG_WRN("DTLS handshake failed (-0x%04x), %ld so far", -r, atomic_get(&failed));
	}
	return r;
}

uint32_t dtls_handshakes_failed(void)
{
	return atomic_get(&failed);
}
```

## src/health.c
```c
/* /sys/health: the node's own health, for operations, as CBOR
 * {"batt": mV, "rssi": dBm, "up": s, "hsfail": n}. GET it, or observe it for a
 * CON notification every report period. "health" in the shell prints the same
 * values and changes the period.
 *
 * The battery is simulated, since these boards run from USB: it starts at
 * 3300 mV and loses 1 mV a minute. "health batt <mV>" sets it, to rehearse a
 * low-battery alert.
 */
#include <stdlib.h>
#include <zephyr/kernel.h>
#include <zephyr/logging/log.h>
#include <zephyr/net/coap_service.h>
#include <zephyr/shell/shell.h>
#include <zephyr/sys/util.h>
#include <zcbor_encode.h>
#include <openthread.h>
#include <openthread/thread.h>

#include "app.h"

LOG_MODULE_REGISTER(health, LOG_LEVEL_INF);

#define NO_LINK_DBM (-127)

static uint32_t period_s = CONFIG_LAB_HEALTH_PERIOD_S;
static int32_t batt_start_mv = 3300;
static int64_t batt_start_ms;
static int64_t last_notify_ms;
static uint16_t notify_size;

static uint32_t batt_mv(void)
{
	int64_t drop = (k_uptime_get() - batt_start_ms) / (60 * MSEC_PER_SEC);

	return MAX(batt_start_mv - drop, 0);
}

/* Average RSSI of the link this node depends on: its parent if it is a
 * child, otherwise its strongest neighbouring router.
 */
static int8_t link_rssi(void)
{
	otInstance *ot = openthread_get_default_instance();
	int8_t best = NO_LINK_DBM;

	openthread_mutex_lock();
	if (otThreadGetDeviceRole(ot) == OT_DEVICE_ROLE_CHILD) {
		(void)otThreadGetParentAverageRssi(ot, &best);
	} else {
		otNeighborInfoIterator it = OT_NEIGHBOR_INFO_ITERATOR_INIT;
		otNeighborInfo info;

		while (otThreadGetNextNeighborInfo(ot, &it, &info) == OT_ERROR_NONE) {
			if (!info.mIsChild && info.mAverageRssi > best) {
				best = info.mAverageRssi;
			}
		}
	}
	openthread_mutex_unlock();

	return best;
}

static size_t encode_health(uint8_t *buf, size_t size)
{
	ZCBOR_STATE_E(zs, 1, buf, size, 1);

	if (!(zcbor_map_start_encode(zs, 4) &&
	      zcbor_tstr_put_lit(zs, "batt") && zcbor_uint32_put(zs, batt_mv()) &&
	      zcbor_tstr_put_lit(zs, "rssi") && zcbor_int32_put(zs, link_rssi()) &&
	      zcbor_tstr_put_lit(zs, "up") && zcbor_uint32_put(zs, k_uptime_get() / MSEC_PER_SEC) &&
	      zcbor_tstr_put_lit(zs, "hsfail") && zcbor_uint32_put(zs, dtls_handshakes_failed()) &&
	      zcbor_map_end_encode(zs, 4))) {
		return 0;
	}

	return zs->payload - buf;
}

/* Observe (6), Content-Format (12), Max-Age (14), in option-number order */
static int build_health(struct coap_packet *pkt, bool observe, int seq)
{
	uint8_t cbor[48];
	size_t n = encode_health(cbor, sizeof(cbor));
	int r = n ? 0 : -ENOMEM;

	if (r == 0 && observe) {
		r = coap_append_option_int(pkt, COAP_OPTION_OBSERVE, seq);
	}
	if (r == 0) {
		r = coap_append_option_int(pkt, COAP_OPTION_CONTENT_FORMAT,
					   COAP_CONTENT_FORMAT_APP_CBOR);
	}
	if (r == 0) {
		r = coap_append_option_int(pkt, COAP_OPTION_MAX_AGE, period_s);
	}
	if (r == 0) {
		r = coap_packet_append_payload_marker(pkt);
	}
	if (r == 0) {
		r = coap_packet_append_payload(pkt, cbor, n);
	}

	return r;
}

static int health_get(struct coap_resource *res, struct coap_packet *req,
		      struct net_sockaddr *addr, net_socklen_t addr_len)
{
	uint8_t buf[CONFIG_COAP_SERVER_MESSAGE_SIZE];
	struct coap_packet rsp;
	char peer[NET_IPV6_ADDR_LEN];
	int obs = coap_resource_parse_observe(res, req, addr);
	int r = response_init(&rsp, buf, sizeof(buf), req, COAP_RESPONSE_CODE_CONTENT);

	if (r == 0) {
		r = build_health(&rsp, obs == 0, res->age);
	}
	if (r < 0) {
		return r;
	}
	if (obs == 0) {
		last_notify_ms = k_uptime_get();  /* this response is the first report */
	}

	LOG_INF("GET /sys/health from %s%s: 2.05, CoAP %u B", peer_str(addr, peer, sizeof(peer)),
		obs == 0 ? " (observe)" : obs == 1 ? " (cancel)" : "", rsp.offset);

	return coap_resource_send(res, &rsp, addr, addr_len, NULL);
}

/* CON, so an observer that vanished is dropped after its retransmissions fail */
static void health_notify(struct coap_resource *res, struct coap_observer *obs)
{
	uint8_t buf[CONFIG_COAP_SERVER_MESSAGE_SIZE];
	struct coap_packet pkt;
	int r = coap_packet_init(&pkt, buf, sizeof(buf), COAP_VERSION_1, COAP_TYPE_CON, obs->tkl,
				 obs->token, COAP_RESPONSE_CODE_CONTENT, coap_next_id());

	if (r == 0) {
		r = build_health(&pkt, true, res->age);
	}
	if (r == 0) {
		notify_size = pkt.offset;
		r = coap_resource_send(res, &pkt, net_sad(&obs->addr),
				       net_family2size(obs->addr.ss_family), NULL);
	}
	if (r < 0) {
		LOG_WRN("Health notification failed (%d)", r);
	}
}

static const char *const health_path[] = { "sys", "health", NULL };
COAP_RESOURCE_DEFINE(sys_health, soilsense, {
	.get = health_get,
	.path = health_path,
	.notify = health_notify,
});

static void report(struct k_work *work)
{
	int64_t now = k_uptime_get();

	if (!sys_slist_is_empty(&sys_health.observers) &&
	    now - last_notify_ms >= (int64_t)period_s * MSEC_PER_SEC) {
		last_notify_ms = now;
		coap_resource_notify(&sys_health);
		LOG_INF("notify /sys/health (CON): CoAP %u B, next in %u s", notify_size, period_s);
	}
	k_work_schedule(k_work_delayable_from_work(work), K_SECONDS(1));
}

static K_WORK_DELAYABLE_DEFINE(report_work, report);

static int health_init(void)
{
	last_notify_ms = k_uptime_get();
	k_work_schedule(&report_work, K_SECONDS(1));
	return 0;
}

SYS_INIT(health_init, APPLICATION, CONFIG_APPLICATION_INIT_PRIORITY);

static int cmd_health(const struct shell *sh, size_t argc, char **argv)
{
	shell_print(sh, "batt:   %u mV (simulated)", batt_mv());
	shell_print(sh, "rssi:   %d dBm", link_rssi());
	shell_print(sh, "up:     %lld s", k_uptime_get() / MSEC_PER_SEC);
	shell_print(sh, "hsfail: %u failed DTLS handshakes", dtls_handshakes_failed());
	shell_print(sh, "period: %u s", period_s);
	return 0;
}

static int cmd_batt(const struct shell *sh, size_t argc, char **argv)
{
	batt_start_mv = atoi(argv[1]);
	batt_start_ms = k_uptime_get();
	shell_print(sh, "Simulated battery set to %d mV", batt_start_mv);
	return 0;
}

static int cmd_period(const struct shell *sh, size_t argc, char **argv)
{
	int s = atoi(argv[1]);

	if (s < 1) {
		shell_error(sh, "The period is at least 1 s");
		return -EINVAL;
	}
	period_s = s;
	shell_print(sh, "Report period %u s", period_s);
	return 0;
}

SHELL_STATIC_SUBCMD_SET_CREATE(health_cmds,
	SHELL_CMD_ARG(batt, NULL, "Set the simulated battery: <mV>", cmd_batt, 2, 0),
	SHELL_CMD_ARG(period, NULL, "Report period for observers: <s>", cmd_period, 2, 0),
	SHELL_SUBCMD_SET_END);

SHELL_CMD_REGISTER(health, &health_cmds, "Node health: batt, rssi, up, hsfail", cmd_health);
```
