## CMakeLists.txt
```
cmake_minimum_required(VERSION 3.20.0)
find_package(Zephyr REQUIRED HINTS $ENV{ZEPHYR_BASE})
project(lab8_golden)

target_sources(app PRIVATE src/main.c src/reading.c src/env_temp.c src/valve.c src/coaps_client.c
			   src/health.c src/dtls_stats.c src/rate_limit.c src/watchdog.c)
# dtls_stats.c counts failed handshakes by wrapping the Mbed TLS call
target_link_options(app PUBLIC -Wl,--wrap=mbedtls_ssl_handshake)

# Collect the CoAP resources of the "soilsense" service into one list
zephyr_linker_sources(DATA_SECTIONS sections-ram.ld)
zephyr_iterable_section(NAME coap_resource_soilsense GROUP DATA_REGION ${XIP_ALIGN_WITH_INPUT})
```

## Kconfig
```
# BMP280: measure on request and sleep in between, instead of sampling
# continuously. Declared before Kconfig.zephyr so this default comes first.
choice BME280_MODE
	default BME280_MODE_FORCED
endchoice

config LAB_PSK
	string "DTLS pre-shared key"
	help
	  The key every client must hold. Set it in secrets.conf, which git
	  ignores, and build with -DEXTRA_CONF_FILE=secrets.conf.

config LAB_PSK_ID
	string "DTLS PSK identity"
	default "soilsense-pilot"

config LAB_HEALTH_PERIOD_S
	int "Seconds between /sys/health notifications"
	default 60

config LAB_RATE_LIMIT_MAX
	int "Requests a client may send per window before 4.29"
	default 8

config LAB_RATE_LIMIT_WINDOW_S
	int "Rate-limit window, in seconds"
	default 10

config LAB_FAILSAFE_S
	int "Seconds without any neighbour before an open valve closes itself"
	default 30

config LAB_WATCHDOG_S
	int "Seconds a monitored loop may stall before the watchdog resets the node"
	default 10

source "Kconfig.zephyr"
```

## prj.conf
```kconfig
CONFIG_LOG=y
CONFIG_MAIN_STACK_SIZE=4096
CONFIG_CBPRINTF_FP_SUPPORT=y

# Networking over 802.15.4 (Interface Capability)
CONFIG_NETWORKING=y
CONFIG_NET_L2_OPENTHREAD=y
CONFIG_NET_UDP=y
# Without this every board in the room auto-joins the same default network on
# channel 11 at boot.
CONFIG_OPENTHREAD_MANUAL_START=y
CONFIG_OPENTHREAD_PING_SENDER=y
# Lab 5: build a global address from the prefix a Border Router advertises.
CONFIG_OPENTHREAD_SLAAC=y
# The 0 dBm default barely reaches past a few centimetres on these boards.
CONFIG_OPENTHREAD_DEFAULT_TX_POWER=20

# Settings backend for the Thread dataset
CONFIG_NVS=y

# OpenThread CLI as "ot <command>", including the "ot coap" client
CONFIG_SHELL=y
CONFIG_NET_SHELL=y
CONFIG_OPENTHREAD_SHELL=y
CONFIG_OPENTHREAD_COAP=y
CONFIG_OPENTHREAD_COAP_OBSERVE=y
# "ot dataset set active <hex>" is ~240 characters; the defaults truncate a paste.
CONFIG_SHELL_CMD_BUFF_SIZE=512
CONFIG_SHELL_BACKEND_SERIAL_RX_RING_BUFFER_SIZE=512
CONFIG_OPENTHREAD_MAC_FILTER=y

# CoAP server: /env/temp and /act/valve, over DTLS on UDP 5684 (CoAPS)
CONFIG_COAP=y
CONFIG_COAP_SERVER=y
CONFIG_COAP_SERVICE_OBSERVERS=4

# CBOR payloads; canonical = definite-length maps (A1, not BF ... FF)
CONFIG_ZCBOR=y
CONFIG_ZCBOR_CANONICAL=y

# Sensor drivers; the overlay in sensors/ picks the one that is built
CONFIG_SENSOR=y
CONFIG_I2C=y
CONFIG_W1=y

# RGB LED: Thread role, or white while the valve is open
CONFIG_LED_STRIP=y

# DTLS 1.2 with a pre-shared key, TLS_PSK_WITH_AES_128_CCM_8. OpenThread's
# default security profile locks the Mbed TLS options, so the custom profile
# repeats what OpenThread needs and adds DTLS and PSK.
CONFIG_OPENTHREAD_SECURITY_CUSTOM_CONFIG=y
CONFIG_MBEDTLS=y
CONFIG_MBEDTLS_ENABLE_HEAP=y
CONFIG_MBEDTLS_MD_C=y
CONFIG_MBEDTLS_ASN1_PARSE_C=y
CONFIG_SECURE_STORAGE=y
CONFIG_PSA_WANT_KEY_TYPE_AES=y
CONFIG_PSA_WANT_KEY_TYPE_HMAC=y
CONFIG_PSA_WANT_ALG_ECB_NO_PADDING=y
CONFIG_PSA_WANT_ALG_HMAC=y
CONFIG_PSA_WANT_ALG_CCM=y
CONFIG_PSA_WANT_ALG_CMAC=y
CONFIG_PSA_WANT_ALG_SHA_256=y
CONFIG_MBEDTLS_SSL_PROTO_TLS1_2=y
CONFIG_MBEDTLS_SSL_PROTO_DTLS=y
CONFIG_MBEDTLS_KEY_EXCHANGE_PSK_ENABLED=y
CONFIG_PSA_WANT_ALG_TLS12_PRF=y
CONFIG_PSA_WANT_ALG_TLS12_PSK_TO_MS=y
CONFIG_PSA_WANT_KEY_TYPE_DERIVE=y
CONFIG_MBEDTLS_SSL_IN_CONTENT_LEN=1024
CONFIG_MBEDTLS_SSL_OUT_CONTENT_LEN=1024
CONFIG_MBEDTLS_HEAP_SIZE=32768

CONFIG_TLS_CREDENTIALS=y
CONFIG_NET_SOCKETS_SOCKOPT_TLS=y
CONFIG_NET_SOCKETS_ENABLE_DTLS=y
# Two DTLS sockets: the server and the "coaps" shell client. The server keeps
# a session per client (the shell on another board, a laptop, a bridge).
CONFIG_NET_SOCKETS_TLS_MAX_CONTEXTS=2
CONFIG_NET_SOCKETS_TLS_MAX_SESSION_CONTEXTS=4
# A session survives 2 min of client silence: longer than the 45 s Observe
# heartbeat, whose ACK keeps an observer's session alive.
CONFIG_NET_SOCKETS_DTLS_TIMEOUT=120000

# The "coaps" shell client runs the DTLS handshake on the shell thread
CONFIG_SHELL_STACK_SIZE=8192

# Lab 8, the Golden Master: a stalled loop resets the node (task watchdog, with
# the hardware watchdog as fallback), and stack canaries catch overflows.
CONFIG_WATCHDOG=y
CONFIG_TASK_WDT=y
CONFIG_TASK_WDT_HW_FALLBACK=y
CONFIG_STACK_CANARIES=y
```

## src/main.c
```c
#include <zephyr/kernel.h>
#include <zephyr/logging/log.h>
#include <zephyr/drivers/led_strip.h>
#include <zephyr/net/coap_service.h>
#include <zephyr/net/tls_credentials.h>
#include <zephyr/app_version.h>
#include <openthread.h>
#include <openthread/thread.h>
#include <openthread/dataset.h>

#include "app.h"

LOG_MODULE_REGISTER(lab8_golden, LOG_LEVEL_INF);

BUILD_ASSERT(sizeof(CONFIG_LAB_PSK) > 1,
	     "No DTLS key: copy secrets.conf.example to secrets.conf, set the key, and build with "
	     "-DEXTRA_CONF_FILE=secrets.conf");

#define PSK_TAG 1

static uint16_t coaps_port = 5684;
static const sec_tag_t sec_tags[] = { PSK_TAG };

/* Started from main() once the PSK is registered. On the board where you run
 * "ot coaps start", OpenThread binds port 5684 itself and keeps the traffic,
 * so that board acts as the client and this server stays silent.
 */
COAPS_SERVICE_DEFINE(soilsense, NULL, &coaps_port, 0, sec_tags, sizeof(sec_tags));

static const struct device *const strip = DEVICE_DT_GET(DT_ALIAS(led_strip));

/* Thread role → LED colour, indexed by otDeviceRole */
static const struct led_rgb role_colors[] = {
	[OT_DEVICE_ROLE_DISABLED] = { .r = 0x00, .g = 0x00, .b = 0x00 },
	[OT_DEVICE_ROLE_DETACHED] = { .r = 0x20, .g = 0x00, .b = 0x00 },
	[OT_DEVICE_ROLE_CHILD]    = { .r = 0x20, .g = 0x18, .b = 0x00 },
	[OT_DEVICE_ROLE_ROUTER]   = { .r = 0x00, .g = 0x20, .b = 0x00 },
	[OT_DEVICE_ROLE_LEADER]   = { .r = 0x00, .g = 0x00, .b = 0x20 },
};
static const struct led_rgb valve_open_color = { .r = 0x30, .g = 0x30, .b = 0x30 };

static atomic_t role = ATOMIC_INIT(OT_DEVICE_ROLE_DISABLED);
static atomic_t valve_open;

/* The OpenThread callback runs with the stack locked; drive the LED from the system workqueue */
static void led_work_handler(struct k_work *work)
{
	struct led_rgb pixel = atomic_get(&valve_open) ? valve_open_color
						       : role_colors[atomic_get(&role)];

	if (led_strip_update_rgb(strip, &pixel, 1) != 0) {
		LOG_ERR("Failed to drive LED");
	}
}

static K_WORK_DEFINE(led_work, led_work_handler);

void led_show_valve(bool open)
{
	atomic_set(&valve_open, open);
	k_work_submit(&led_work);
}

static void ot_state_changed(otChangedFlags flags, void *user_data)
{
	if (!(flags & OT_CHANGED_THREAD_ROLE)) {
		return;
	}

	otDeviceRole r = otThreadGetDeviceRole(openthread_get_default_instance());

	LOG_INF("Thread role: %s", otThreadDeviceRoleToString(r));
	atomic_set(&role, r);
	k_work_submit(&led_work);
}

static struct openthread_state_changed_callback ot_state_cb = {
	.otCallback = ot_state_changed,
};

int response_init(struct coap_packet *rsp, uint8_t *buf, size_t size,
		  const struct coap_packet *req, uint8_t code)
{
	uint8_t token[COAP_TOKEN_MAX_LEN];
	uint8_t tkl = coap_header_get_token(req, token);
	bool con = coap_header_get_type(req) == COAP_TYPE_CON;

	return coap_packet_init(rsp, buf, size, COAP_VERSION_1,
				con ? COAP_TYPE_ACK : COAP_TYPE_NON_CON, tkl, token, code,
				con ? coap_header_get_id(req) : coap_next_id());
}

const char *peer_str(const struct net_sockaddr *addr, char *buf, size_t size)
{
	return net_addr_ntop(NET_AF_INET6, &net_sin6(addr)->sin6_addr, buf, size);
}

static int psk_register(void)
{
	int r = tls_credential_add(PSK_TAG, TLS_CREDENTIAL_PSK, CONFIG_LAB_PSK,
				   strlen(CONFIG_LAB_PSK));

	if (r == 0) {
		r = tls_credential_add(PSK_TAG, TLS_CREDENTIAL_PSK_ID, CONFIG_LAB_PSK_ID,
				       strlen(CONFIG_LAB_PSK_ID));
	}

	return r;
}

/* Join the stored network at boot, so a power cut needs nobody at the shell */
static void thread_autostart(void)
{
	bool stored;

	openthread_mutex_lock();
	stored = otDatasetIsCommissioned(openthread_get_default_instance());
	openthread_mutex_unlock();

	if (!stored) {
		LOG_INF("No Thread network stored: set one with \"ot dataset set active <hex>\", "
			"then \"ot ifconfig up\" and \"ot thread start\"");
		return;
	}
	if (openthread_run() == 0) {
		LOG_INF("Rejoining the stored Thread network");
	}
}

int main(void)
{
	int r;

	LOG_INF("SoilSense Golden Master v%s", APP_VERSION_STRING);

	r = psk_register();

	if (r == 0) {
		r = coap_service_start(&soilsense);
	}
	if (r < 0) {
		LOG_ERR("CoAPS server not started (%d)", r);
	}

	if (!device_is_ready(strip)) {
		LOG_ERR("LED strip device not ready");
	} else {
		k_work_submit(&led_work);
		openthread_state_changed_callback_register(&ot_state_cb);
	}

	if (watchdog_start() < 0) {
		LOG_ERR("Watchdog not armed");
	}
	thread_autostart();

	LOG_INF("SoilSense node ready: CoAPS /env/temp (%s), /act/valve and /sys/health on UDP %u, "
		"PSK identity \"%s\". OpenThread commands start with \"ot\".",
		reading_sensor_name(), coaps_port, CONFIG_LAB_PSK_ID);

	return 0;
}
```

## src/app.h
```c
#ifndef APP_H_
#define APP_H_

#include <stdbool.h>
#include <stdint.h>
#include <zephyr/net/coap.h>
#include <zephyr/net/coap_service.h>

void led_show_valve(bool open);

/* Start a response to req: piggybacked ACK for a CON request, NON otherwise */
int response_init(struct coap_packet *rsp, uint8_t *buf, size_t size,
		  const struct coap_packet *req, uint8_t code);

/* Peer address as text, for logs */
const char *peer_str(const struct net_sockaddr *addr, char *buf, size_t size);

/* Last reading that passed the plausibility checks */
struct reading {
	bool valid;     /* false until the first accepted reading */
	float t;        /* °C */
	int64_t at_ms;  /* uptime when it was taken */
	uint32_t seq;   /* increments with every accepted reading */
};

struct reading reading_get(void);

/* Name of the sensor in the devicetree, or "simulated" */
const char *reading_sensor_name(void);

/* Failed DTLS handshakes since boot (dtls_stats.c) */
uint32_t dtls_handshakes_failed(void);

/* Answers 4.29 when the peer is over its request budget: 0 when the request may
 * go on, 1 when the 4.29 was sent, negative on error (rate_limit.c)
 */
int rate_limit_check(struct coap_resource *res, const struct coap_packet *req,
		     struct net_sockaddr *addr, net_socklen_t addr_len);

/* Task watchdog (watchdog.c) */
int watchdog_start(void);
void watchdog_feed_sampler(void);

#endif
```

## src/coaps_client.c
```c
/* "coaps" shell command: a CoAP client over DTLS with this node's PSK, for
 * requests from inside the mesh. The OpenThread shell's own CoAPS client
 * doesn't build against Mbed TLS 4, so this one uses Zephyr's DTLS sockets.
 * Each command opens one DTLS session, prints how long its handshake took,
 * sends its requests over it and closes it.
 */
#include <stdlib.h>
#include <string.h>
#include <zephyr/kernel.h>
#include <zephyr/net/coap.h>
#include <zephyr/net/socket.h>
#include <zephyr/net/tls_credentials.h>
#include <zephyr/random/random.h>
#include <zephyr/shell/shell.h>

#define CLIENT_TAG    2
#define COAPS_PORT    5684
#define ACK_TIMEOUT_MS 2000
#define MAX_RETRANSMIT 4

static char key[CONFIG_MBEDTLS_PSK_MAX_LEN + 1] = CONFIG_LAB_PSK;

static int key_install(const struct shell *sh)
{
	(void)tls_credential_delete(CLIENT_TAG, TLS_CREDENTIAL_PSK);
	(void)tls_credential_delete(CLIENT_TAG, TLS_CREDENTIAL_PSK_ID);

	int r = tls_credential_add(CLIENT_TAG, TLS_CREDENTIAL_PSK, key, strlen(key));

	if (r == 0) {
		r = tls_credential_add(CLIENT_TAG, TLS_CREDENTIAL_PSK_ID, CONFIG_LAB_PSK_ID,
				       strlen(CONFIG_LAB_PSK_ID));
	}
	if (r < 0) {
		shell_error(sh, "Can't install the PSK (%d)", r);
	}
	return r;
}

/* DTLS session to [addr]:5684; the handshake runs inside connect() */
static int session_open(const struct shell *sh, const char *addr_str)
{
	struct net_sockaddr_in6 addr = {
		.sin6_family = NET_AF_INET6,
		.sin6_port = net_htons(COAPS_PORT),
	};
	static const sec_tag_t tags[] = { CLIENT_TAG };

	if (net_addr_pton(NET_AF_INET6, addr_str, &addr.sin6_addr) < 0) {
		shell_error(sh, "Not an IPv6 address: %s", addr_str);
		return -EINVAL;
	}
	if (key_install(sh) < 0) {
		return -EINVAL;
	}

	int fd = zsock_socket(NET_AF_INET6, NET_SOCK_DGRAM, NET_IPPROTO_DTLS_1_2);

	if (fd < 0) {
		shell_error(sh, "No DTLS socket (%d)", -errno);
		return -errno;
	}
	if (zsock_setsockopt(fd, ZSOCK_SOL_TLS, ZSOCK_TLS_SEC_TAG_LIST, tags, sizeof(tags)) < 0) {
		shell_error(sh, "Can't set the PSK tag (%d)", -errno);
		zsock_close(fd);
		return -errno;
	}

	int64_t t0 = k_uptime_get();

	if (zsock_connect(fd, (struct net_sockaddr *)&addr, sizeof(addr)) < 0) {
		int err = errno;

		shell_error(sh, "DTLS handshake failed after %lld ms (%d)", k_uptime_get() - t0, -err);
		zsock_close(fd);
		return -err;
	}
	shell_print(sh, "DTLS handshake: %lld ms", k_uptime_get() - t0);
	return fd;
}

static int build_request(struct coap_packet *req, uint8_t *buf, size_t size, uint8_t method,
			 const char *path, int value)
{
	uint32_t token = sys_rand32_get();
	char segs[64];
	int r;

	r = coap_packet_init(req, buf, size, COAP_VERSION_1, COAP_TYPE_CON, sizeof(token),
			     (uint8_t *)&token, method, coap_next_id());
	strncpy(segs, path, sizeof(segs) - 1);
	segs[sizeof(segs) - 1] = '\0';
	for (char *save, *s = strtok_r(segs, "/", &save); r == 0 && s;
	     s = strtok_r(NULL, "/", &save)) {
		r = coap_packet_append_option(req, COAP_OPTION_URI_PATH, s, strlen(s));
	}
	if (r == 0 && value >= 0) {
		const uint8_t cbor[] = { 0xA1, 0x61, 0x76, (uint8_t)value }; /* {"v": value} */

		r = coap_append_option_int(req, COAP_OPTION_CONTENT_FORMAT,
					   COAP_CONTENT_FORMAT_APP_CBOR);
		if (r == 0) {
			r = coap_packet_append_payload_marker(req);
		}
		if (r == 0) {
			r = coap_packet_append_payload(req, cbor, sizeof(cbor));
		}
	}
	return r;
}

/* One CON exchange with RFC 7252 retransmission; prints the response */
static int exchange(const struct shell *sh, int fd, uint8_t method, const char *path, int value)
{
	uint8_t buf[256];
	struct coap_packet req, rsp;
	int r = build_request(&req, buf, sizeof(buf), method, path, value);

	if (r < 0) {
		shell_error(sh, "Can't build the request (%d)", r);
		return r;
	}

	uint16_t id = coap_header_get_id(&req);
	int64_t t0 = k_uptime_get();
	int wait = ACK_TIMEOUT_MS;

	for (int attempt = 0; attempt <= MAX_RETRANSMIT; attempt++, wait *= 2) {
		if (zsock_send(fd, req.data, req.offset, 0) < 0) {
			shell_error(sh, "Send failed (%d)", -errno);
			return -errno;
		}

		struct zsock_pollfd pfd = { .fd = fd, .events = ZSOCK_POLLIN };

		while (zsock_poll(&pfd, 1, wait) > 0) {
			uint8_t in[256];
			int n = zsock_recv(fd, in, sizeof(in), 0);

			if (n <= 0 || coap_packet_parse(&rsp, in, n, NULL, 0) < 0 ||
			    coap_header_get_id(&rsp) != id) {
				continue;
			}

			uint8_t code = coap_header_get_code(&rsp);
			uint16_t len;
			const uint8_t *p = coap_packet_get_payload(&rsp, &len);
			char hex[2 * 32 + 1] = "";

			for (int i = 0; p && i < len && i < 32; i++) {
				snprintk(&hex[2 * i], 3, "%02x", p[i]);
			}
			shell_print(sh, "%u.%02u, payload %s, RTT %lld ms", code >> 5, code & 0x1f,
				    len ? hex : "(none)", k_uptime_get() - t0);
			return 0;
		}
	}
	shell_error(sh, "No response after %d transmissions", MAX_RETRANSMIT + 1);
	return -ETIMEDOUT;
}

static int cmd_get(const struct shell *sh, size_t argc, char **argv)
{
	int count = argc > 3 ? atoi(argv[3]) : 1;
	int fd = session_open(sh, argv[1]);

	if (fd < 0) {
		return fd;
	}
	for (int i = 0; i < count; i++) {
		(void)exchange(sh, fd, COAP_METHOD_GET, argv[2], -1);
	}
	zsock_close(fd);
	return 0;
}

static int cmd_put(const struct shell *sh, size_t argc, char **argv)
{
	int value = atoi(argv[3]);

	if (strlen(argv[3]) != 1 || (value != 0 && value != 1)) {
		shell_error(sh, "The valve takes 0 or 1");
		return -EINVAL;
	}

	int fd = session_open(sh, argv[1]);

	if (fd < 0) {
		return fd;
	}
	(void)exchange(sh, fd, COAP_METHOD_PUT, argv[2], value);
	zsock_close(fd);
	return 0;
}

static int cmd_key(const struct shell *sh, size_t argc, char **argv)
{
	const char *k = strcmp(argv[1], "default") == 0 ? CONFIG_LAB_PSK : argv[1];

	if (strlen(k) >= sizeof(key)) {
		shell_error(sh, "Key longer than %u characters", sizeof(key) - 1);
		return -EINVAL;
	}
	strcpy(key, k);
	shell_print(sh, "Client PSK set (identity \"%s\")", CONFIG_LAB_PSK_ID);
	return 0;
}

SHELL_STATIC_SUBCMD_SET_CREATE(coaps_cmds,
	SHELL_CMD_ARG(get, NULL, "GET over DTLS: <addr> <path> [count]", cmd_get, 3, 1),
	SHELL_CMD_ARG(put, NULL, "PUT {\"v\": 0|1} over DTLS: <addr> <path> <0|1>", cmd_put, 4, 0),
	SHELL_CMD_ARG(key, NULL, "Client PSK: <key> | default", cmd_key, 2, 0),
	SHELL_SUBCMD_SET_END);

SHELL_CMD_REGISTER(coaps, &coaps_cmds, "CoAP client over DTLS with a pre-shared key", NULL);
```

## src/env_temp.c
```c
/* /env/temp: temperature as CBOR {"t": float16}, readable with GET and pushed
 * to observers (RFC 7641) when it moves more than THRESHOLD_C, or every
 * HEARTBEAT_S seconds if it doesn't. A reading is served for at most MAX_AGE_S
 * after it was taken: Max-Age counts down as it ages, and once no accepted
 * reading is that recent, GET answers 5.03 and every observation ends with a
 * 5.03 notification.
 */
#include <math.h>
#include <zephyr/kernel.h>
#include <zephyr/logging/log.h>
#include <zephyr/net/coap_service.h>
#include <zephyr/sys/util.h>
#include <zcbor_encode.h>

#include "app.h"

LOG_MODULE_REGISTER(env_temp, LOG_LEVEL_INF);

#define THRESHOLD_C 0.5f
#define HEARTBEAT_S 45
#define MAX_AGE_S   60
#define RETRY_S     10  /* Max-Age of a 5.03: when the client may ask again */

static const char unavailable_msg[] = "no fresh reading";

static float last_notified_c;
static int64_t last_notify_ms;
static uint8_t notify_type = COAP_TYPE_NON_CON;
static bool fresh, been_fresh;
static uint32_t n_threshold, n_heartbeat;
static uint16_t notify_size;

/* Observations being ended with a 5.03, collected while notifying */
static bool ending;
static struct {
	uint8_t token[COAP_TOKEN_MAX_LEN];
	uint8_t tkl;
} ended[CONFIG_COAP_SERVICE_OBSERVERS];
static int n_ended;

/* Seconds the reading stays fresh; 0 once it is too old to serve */
static uint32_t freshness_s(const struct reading *r, int64_t now)
{
	int64_t age_s;

	if (!r->valid) {
		return 0;
	}
	age_s = (now - r->at_ms) / MSEC_PER_SEC;

	return age_s < MAX_AGE_S ? MAX_AGE_S - age_s : 0;
}

/* A1 61 74 F9 hh ll = {"t": <half-precision float>} */
static size_t encode_reading(float t, uint8_t *buf, size_t size)
{
	ZCBOR_STATE_E(zs, 1, buf, size, 1);

	if (!(zcbor_map_start_encode(zs, 1) && zcbor_tstr_put_lit(zs, "t") &&
	      zcbor_float16_put(zs, t) && zcbor_map_end_encode(zs, 1))) {
		return 0;
	}

	return zs->payload - buf;
}

/* Options must be appended in option-number order: Observe (6),
 * Content-Format (12), Max-Age (14).
 */
static int build_reading(struct coap_packet *pkt, bool observe, int seq, const uint8_t *cbor,
			 size_t n, uint32_t max_age)
{
	int r = 0;

	if (n == 0) {
		return -ENOMEM;
	}
	if (observe) {
		r = coap_append_option_int(pkt, COAP_OPTION_OBSERVE, seq);
	}
	if (r == 0) {
		r = coap_append_option_int(pkt, COAP_OPTION_CONTENT_FORMAT,
					   COAP_CONTENT_FORMAT_APP_CBOR);
	}
	if (r == 0) {
		r = coap_append_option_int(pkt, COAP_OPTION_MAX_AGE, max_age);
	}
	if (r == 0) {
		r = coap_packet_append_payload_marker(pkt);
	}
	if (r == 0) {
		r = coap_packet_append_payload(pkt, cbor, n);
	}

	return r;
}

/* 5.03 with Max-Age = when to retry, and a diagnostic text payload. Error
 * responses carry no Observe option (RFC 7641 §4.2), which is what ends an
 * observation on the client.
 */
static int build_unavailable(struct coap_packet *pkt)
{
	int r = coap_append_option_int(pkt, COAP_OPTION_MAX_AGE, RETRY_S);

	if (r == 0) {
		r = coap_packet_append_payload_marker(pkt);
	}
	if (r == 0) {
		r = coap_packet_append_payload(pkt, unavailable_msg, sizeof(unavailable_msg) - 1);
	}

	return r;
}

static int env_temp_get(struct coap_resource *res, struct coap_packet *req,
			struct net_sockaddr *addr, net_socklen_t addr_len)
{
	uint8_t buf[CONFIG_COAP_SERVER_MESSAGE_SIZE];
	struct coap_packet rsp;
	char peer[NET_IPV6_ADDR_LEN];
	uint8_t cbor[8];
	size_t n;
	char hex[2 * sizeof(cbor) + 1];
	struct reading reading = reading_get();
	int64_t now = k_uptime_get();
	uint32_t max_age = freshness_s(&reading, now);
	int obs, r = rate_limit_check(res, req, addr, addr_len);

	if (r != 0) {
		return r < 0 ? r : 0;
	}
	peer_str(addr, peer, sizeof(peer));

	if (max_age == 0) {
		r = response_init(&rsp, buf, sizeof(buf), req,
				  COAP_RESPONSE_CODE_SERVICE_UNAVAILABLE);
		if (r == 0) {
			r = build_unavailable(&rsp);
		}
		if (r < 0) {
			return r;
		}
		LOG_WRN("GET /env/temp from %s: 5.03, no reading younger than %d s, retry in %d s",
			peer, MAX_AGE_S, RETRY_S);
		return coap_resource_send(res, &rsp, addr, addr_len, NULL);
	}

	obs = coap_resource_parse_observe(res, req, addr);
	n = encode_reading(reading.t, cbor, sizeof(cbor));
	r = response_init(&rsp, buf, sizeof(buf), req, COAP_RESPONSE_CODE_CONTENT);
	if (r == 0) {
		r = build_reading(&rsp, obs == 0, res->age, cbor, n, max_age);
	}
	if (r < 0) {
		return r;
	}

	if (obs == 0) {
		/* Count the next notification from this reading */
		last_notified_c = reading.t;
		last_notify_ms = now;
	}

	bin2hex(cbor, n, hex, sizeof(hex));
	LOG_INF("GET /env/temp from %s%s: 2.05, %.2f C, %llds old, Max-Age %u (CBOR %s)", peer,
		obs == 0 ? " (observe)" : obs == 1 ? " (cancel)" : "", (double)reading.t,
		(now - reading.at_ms) / MSEC_PER_SEC, max_age, hex);

	return coap_resource_send(res, &rsp, addr, addr_len, NULL);
}

static void env_temp_notify(struct coap_resource *res, struct coap_observer *obs)
{
	uint8_t buf[CONFIG_COAP_SERVER_MESSAGE_SIZE];
	struct coap_packet pkt;
	struct reading reading = reading_get();
	uint8_t code = ending ? COAP_RESPONSE_CODE_SERVICE_UNAVAILABLE
			      : COAP_RESPONSE_CODE_CONTENT;
	int r;

	r = coap_packet_init(&pkt, buf, sizeof(buf), COAP_VERSION_1, notify_type, obs->tkl,
			     obs->token, code, coap_next_id());
	if (r == 0 && ending) {
		r = build_unavailable(&pkt);
		if (n_ended < ARRAY_SIZE(ended)) {
			memcpy(ended[n_ended].token, obs->token, obs->tkl);
			ended[n_ended++].tkl = obs->tkl;
		}
	} else if (r == 0) {
		uint8_t cbor[8];
		size_t n = encode_reading(reading.t, cbor, sizeof(cbor));

		r = build_reading(&pkt, true, res->age, cbor, n,
				  freshness_s(&reading, k_uptime_get()));
	}
	if (r == 0) {
		notify_size = pkt.offset;
		r = coap_resource_send(res, &pkt, net_sad(&obs->addr),
				       net_family2size(obs->addr.ss_family), NULL);
	}
	if (r < 0) {
		LOG_WRN("Notification failed (%d)", r);
	}
}

static const char *const env_temp_path[] = { "env", "temp", NULL };
COAP_RESOURCE_DEFINE(env_temp, soilsense, {
	.get = env_temp_get,
	.path = env_temp_path,
	.notify = env_temp_notify,
});

/* Tell every observer the data is gone (CON, so a vanished one is noticed),
 * then forget them: a client re-registers once readings are fresh again.
 */
static void end_observations(void)
{
	ending = true;
	notify_type = COAP_TYPE_CON;
	n_ended = 0;
	coap_resource_notify(&env_temp);
	ending = false;

	for (int i = 0; i < n_ended; i++) {
		coap_resource_remove_observer_by_token(&env_temp, ended[i].token, ended[i].tkl);
	}
	LOG_WRN("No reading younger than %d s: GET now answers 5.03; %d observation(s) ended",
		MAX_AGE_S, n_ended);
}

/* Observe policy, once a second: notify on a change or a heartbeat while the
 * data is fresh, and end the observations when it stops being fresh.
 */
static void policy(struct k_work *work)
{
	struct reading reading = reading_get();
	int64_t now = k_uptime_get();
	uint32_t max_age = freshness_s(&reading, now);
	float delta;
	bool threshold, heartbeat;

	if ((max_age > 0) != fresh) {
		fresh = max_age > 0;
		if (fresh) {
			if (been_fresh) {
				LOG_INF("Fresh readings again: GET answers 2.05; observers must "
					"register again");
			}
			been_fresh = true;
			last_notified_c = reading.t;
			last_notify_ms = now;
		} else {
			end_observations();
		}
	}

	if (fresh && !sys_slist_is_empty(&env_temp.observers)) {
		delta = fabsf(reading.t - last_notified_c);
		threshold = delta > THRESHOLD_C;
		heartbeat = now - last_notify_ms >= HEARTBEAT_S * MSEC_PER_SEC;

		if (threshold || heartbeat) {
			/* Heartbeats go CON: if the observer is gone, the retransmissions
			 * fail and the server drops it (RFC 7641 §4.5).
			 */
			notify_type = threshold ? COAP_TYPE_NON_CON : COAP_TYPE_CON;
			if (threshold) {
				n_threshold++;
			} else {
				n_heartbeat++;
			}
			int64_t since_ms = now - last_notify_ms;

			last_notified_c = reading.t;
			last_notify_ms = now;
			coap_resource_notify(&env_temp);
			LOG_INF("notify (%s, %s): T=%.2f C, delta=%.2f C, %llds since last, "
				"reading %llds old, CoAP %u B [threshold %u, heartbeat %u]",
				threshold ? "threshold" : "heartbeat", threshold ? "NON" : "CON",
				(double)reading.t, (double)delta, since_ms / MSEC_PER_SEC,
				(now - reading.at_ms) / MSEC_PER_SEC, notify_size, n_threshold,
				n_heartbeat);
		}
	}

	k_work_schedule(k_work_delayable_from_work(work), K_SECONDS(1));
}

static K_WORK_DELAYABLE_DEFINE(policy_work, policy);

static int env_temp_init(void)
{
	last_notify_ms = k_uptime_get();
	k_work_schedule(&policy_work, K_SECONDS(1));
	return 0;
}

SYS_INIT(env_temp_init, APPLICATION, CONFIG_APPLICATION_INIT_PRIORITY);
```

## src/health.c
```c
/* /sys/health: the node's own health, for operations, as CBOR
 * {"batt": mV, "rssi": dBm, "up": s, "hsfail": n, "ver": "x.y.z"}. GET it, or observe it for a
 * CON notification every report period. "health" in the shell prints the same
 * values and changes the period.
 *
 * The battery is simulated, since these boards run from USB: it starts at
 * 3300 mV and loses 1 mV a minute. "health batt <mV>" sets it, to rehearse a
 * low-battery alert.
 */
#include <stdlib.h>
#include <zephyr/kernel.h>
#include <zephyr/logging/log.h>
#include <zephyr/net/coap_service.h>
#include <zephyr/shell/shell.h>
#include <zephyr/app_version.h>
#include <zephyr/sys/util.h>
#include <zcbor_encode.h>
#include <openthread.h>
#include <openthread/thread.h>

#include "app.h"

LOG_MODULE_REGISTER(health, LOG_LEVEL_INF);

#define NO_LINK_DBM (-127)

static uint32_t period_s = CONFIG_LAB_HEALTH_PERIOD_S;
static int32_t batt_start_mv = 3300;
static int64_t batt_start_ms;
static int64_t last_notify_ms;
static uint16_t notify_size;

static uint32_t batt_mv(void)
{
	int64_t drop = (k_uptime_get() - batt_start_ms) / (60 * MSEC_PER_SEC);

	return MAX(batt_start_mv - drop, 0);
}

/* Average RSSI of the link this node depends on: its parent if it is a
 * child, otherwise its strongest neighbouring router.
 */
static int8_t link_rssi(void)
{
	otInstance *ot = openthread_get_default_instance();
	int8_t best = NO_LINK_DBM;

	openthread_mutex_lock();
	if (otThreadGetDeviceRole(ot) == OT_DEVICE_ROLE_CHILD) {
		(void)otThreadGetParentAverageRssi(ot, &best);
	} else {
		otNeighborInfoIterator it = OT_NEIGHBOR_INFO_ITERATOR_INIT;
		otNeighborInfo info;

		while (otThreadGetNextNeighborInfo(ot, &it, &info) == OT_ERROR_NONE) {
			if (!info.mIsChild && info.mAverageRssi > best) {
				best = info.mAverageRssi;
			}
		}
	}
	openthread_mutex_unlock();

	return best;
}

static size_t encode_health(uint8_t *buf, size_t size)
{
	ZCBOR_STATE_E(zs, 1, buf, size, 1);

	if (!(zcbor_map_start_encode(zs, 5) &&
	      zcbor_tstr_put_lit(zs, "batt") && zcbor_uint32_put(zs, batt_mv()) &&
	      zcbor_tstr_put_lit(zs, "rssi") && zcbor_int32_put(zs, link_rssi()) &&
	      zcbor_tstr_put_lit(zs, "up") && zcbor_uint32_put(zs, k_uptime_get() / MSEC_PER_SEC) &&
	      zcbor_tstr_put_lit(zs, "hsfail") && zcbor_uint32_put(zs, dtls_handshakes_failed()) &&
	      zcbor_tstr_put_lit(zs, "ver") && zcbor_tstr_put_lit(zs, APP_VERSION_STRING) &&
	      zcbor_map_end_encode(zs, 5))) {
		return 0;
	}

	return zs->payload - buf;
}

/* Observe (6), Content-Format (12), Max-Age (14), in option-number order */
static int build_health(struct coap_packet *pkt, bool observe, int seq)
{
	uint8_t cbor[64];
	size_t n = encode_health(cbor, sizeof(cbor));
	int r = n ? 0 : -ENOMEM;

	if (r == 0 && observe) {
		r = coap_append_option_int(pkt, COAP_OPTION_OBSERVE, seq);
	}
	if (r == 0) {
		r = coap_append_option_int(pkt, COAP_OPTION_CONTENT_FORMAT,
					   COAP_CONTENT_FORMAT_APP_CBOR);
	}
	if (r == 0) {
		r = coap_append_option_int(pkt, COAP_OPTION_MAX_AGE, period_s);
	}
	if (r == 0) {
		r = coap_packet_append_payload_marker(pkt);
	}
	if (r == 0) {
		r = coap_packet_append_payload(pkt, cbor, n);
	}

	return r;
}

static int health_get(struct coap_resource *res, struct coap_packet *req,
		      struct net_sockaddr *addr, net_socklen_t addr_len)
{
	uint8_t buf[CONFIG_COAP_SERVER_MESSAGE_SIZE];
	struct coap_packet rsp;
	char peer[NET_IPV6_ADDR_LEN];
	int obs, r = rate_limit_check(res, req, addr, addr_len);

	if (r != 0) {
		return r < 0 ? r : 0;
	}
	obs = coap_resource_parse_observe(res, req, addr);
	r = response_init(&rsp, buf, sizeof(buf), req, COAP_RESPONSE_CODE_CONTENT);

	if (r == 0) {
		r = build_health(&rsp, obs == 0, res->age);
	}
	if (r < 0) {
		return r;
	}
	if (obs == 0) {
		last_notify_ms = k_uptime_get();  /* this response is the first report */
	}

	LOG_INF("GET /sys/health from %s%s: 2.05, CoAP %u B", peer_str(addr, peer, sizeof(peer)),
		obs == 0 ? " (observe)" : obs == 1 ? " (cancel)" : "", rsp.offset);

	return coap_resource_send(res, &rsp, addr, addr_len, NULL);
}

/* CON, so an observer that vanished is dropped after its retransmissions fail */
static void health_notify(struct coap_resource *res, struct coap_observer *obs)
{
	uint8_t buf[CONFIG_COAP_SERVER_MESSAGE_SIZE];
	struct coap_packet pkt;
	int r = coap_packet_init(&pkt, buf, sizeof(buf), COAP_VERSION_1, COAP_TYPE_CON, obs->tkl,
				 obs->token, COAP_RESPONSE_CODE_CONTENT, coap_next_id());

	if (r == 0) {
		r = build_health(&pkt, true, res->age);
	}
	if (r == 0) {
		notify_size = pkt.offset;
		r = coap_resource_send(res, &pkt, net_sad(&obs->addr),
				       net_family2size(obs->addr.ss_family), NULL);
	}
	if (r < 0) {
		LOG_WRN("Health notification failed (%d)", r);
	}
}

static const char *const health_path[] = { "sys", "health", NULL };
COAP_RESOURCE_DEFINE(sys_health, soilsense, {
	.get = health_get,
	.path = health_path,
	.notify = health_notify,
});

static void report(struct k_work *work)
{
	int64_t now = k_uptime_get();

	if (!sys_slist_is_empty(&sys_health.observers) &&
	    now - last_notify_ms >= (int64_t)period_s * MSEC_PER_SEC) {
		last_notify_ms = now;
		coap_resource_notify(&sys_health);
		LOG_INF("notify /sys/health (CON): CoAP %u B, next in %u s", notify_size, period_s);
	}
	k_work_schedule(k_work_delayable_from_work(work), K_SECONDS(1));
}

static K_WORK_DELAYABLE_DEFINE(report_work, report);

static int health_init(void)
{
	last_notify_ms = k_uptime_get();
	k_work_schedule(&report_work, K_SECONDS(1));
	return 0;
}

SYS_INIT(health_init, APPLICATION, CONFIG_APPLICATION_INIT_PRIORITY);

static int cmd_health(const struct shell *sh, size_t argc, char **argv)
{
	shell_print(sh, "batt:   %u mV (simulated)", batt_mv());
	shell_print(sh, "rssi:   %d dBm", link_rssi());
	shell_print(sh, "up:     %lld s", k_uptime_get() / MSEC_PER_SEC);
	shell_print(sh, "hsfail: %u failed DTLS handshakes", dtls_handshakes_failed());
	shell_print(sh, "period: %u s", period_s);
	shell_print(sh, "ver:    %s", APP_VERSION_STRING);
	return 0;
}

static int cmd_batt(const struct shell *sh, size_t argc, char **argv)
{
	batt_start_mv = atoi(argv[1]);
	batt_start_ms = k_uptime_get();
	shell_print(sh, "Simulated battery set to %d mV", batt_start_mv);
	return 0;
}

static int cmd_period(const struct shell *sh, size_t argc, char **argv)
{
	int s = atoi(argv[1]);

	if (s < 1) {
		shell_error(sh, "The period is at least 1 s");
		return -EINVAL;
	}
	period_s = s;
	shell_print(sh, "Report period %u s", period_s);
	return 0;
}

/* Chaos drill: block the system workqueue, as a hung handler would. The
 * watchdog should reset the node CONFIG_LAB_WATCHDOG_S seconds later.
 */
static void stall(struct k_work *work)
{
	LOG_WRN("Stalling the system workqueue");
	k_sleep(K_FOREVER);
}

static K_WORK_DEFINE(stall_work, stall);

static int cmd_stall(const struct shell *sh, size_t argc, char **argv)
{
	shell_print(sh, "Blocking the system workqueue; the watchdog should reset in %d s",
		    CONFIG_LAB_WATCHDOG_S);
	k_work_submit(&stall_work);
	return 0;
}

SHELL_STATIC_SUBCMD_SET_CREATE(health_cmds,
	SHELL_CMD_ARG(batt, NULL, "Set the simulated battery: <mV>", cmd_batt, 2, 0),
	SHELL_CMD_ARG(period, NULL, "Report period for observers: <s>", cmd_period, 2, 0),
	SHELL_CMD(stall, NULL, "Chaos drill: hang the system workqueue", cmd_stall),
	SHELL_SUBCMD_SET_END);

SHELL_CMD_REGISTER(health, &health_cmds, "Node health: batt, rssi, up, hsfail", cmd_health);
```

## src/rate_limit.c
```c
/* Per-peer rate limiting: each client may send CONFIG_LAB_RATE_LIMIT_MAX
 * requests per CONFIG_LAB_RATE_LIMIT_WINDOW_S window; more are answered
 * 4.29 Too Many Requests (RFC 8516), with Max-Age = seconds until the window
 * reopens. A few slots track the most recent peers; the stalest is reused.
 * Observe notifications don't pass through here: only requests do.
 */
#include <string.h>
#include <zephyr/kernel.h>
#include <zephyr/logging/log.h>
#include <zephyr/net/coap_service.h>

#include "app.h"

LOG_MODULE_REGISTER(rate_limit, LOG_LEVEL_INF);

#define SLOTS 4
#define WINDOW_MS (CONFIG_LAB_RATE_LIMIT_WINDOW_S * MSEC_PER_SEC)

static struct {
	struct net_in6_addr peer;
	int64_t window_start_ms;
	uint32_t count;
} slots[SLOTS];

static K_MUTEX_DEFINE(lock);

/* Milliseconds until this peer may send again; 0 when the request is allowed */
static int64_t over_limit(const struct net_sockaddr *addr)
{
	const struct net_in6_addr *peer = &net_sin6(addr)->sin6_addr;
	int64_t now = k_uptime_get();
	int64_t wait = 0;
	int i, stalest = 0;

	k_mutex_lock(&lock, K_FOREVER);
	for (i = 0; i < SLOTS; i++) {
		if (memcmp(&slots[i].peer, peer, sizeof(*peer)) == 0) {
			break;
		}
		if (slots[i].window_start_ms < slots[stalest].window_start_ms) {
			stalest = i;
		}
	}
	if (i == SLOTS) {
		i = stalest;
		slots[i].peer = *peer;
		slots[i].window_start_ms = now;
		slots[i].count = 0;
	}
	if (now - slots[i].window_start_ms >= WINDOW_MS) {
		slots[i].window_start_ms = now;
		slots[i].count = 0;
	}
	if (++slots[i].count > CONFIG_LAB_RATE_LIMIT_MAX) {
		wait = slots[i].window_start_ms + WINDOW_MS - now;
	}
	k_mutex_unlock(&lock);

	return wait;
}

int rate_limit_check(struct coap_resource *res, const struct coap_packet *req,
		     struct net_sockaddr *addr, net_socklen_t addr_len)
{
	int64_t wait_ms = over_limit(addr);
	uint8_t buf[64];
	struct coap_packet rsp;
	char peer[NET_IPV6_ADDR_LEN];
	int r;

	if (wait_ms == 0) {
		return 0;
	}

	r = response_init(&rsp, buf, sizeof(buf), req, COAP_RESPONSE_CODE_TOO_MANY_REQUESTS);
	if (r == 0) {
		r = coap_append_option_int(&rsp, COAP_OPTION_MAX_AGE,
					   DIV_ROUND_UP(wait_ms, MSEC_PER_SEC));
	}
	if (r == 0) {
		r = coap_resource_send(res, &rsp, addr, addr_len, NULL);
	}
	LOG_WRN("4.29 to %s: over %d requests in %d s, retry in %lld s",
		peer_str(addr, peer, sizeof(peer)), CONFIG_LAB_RATE_LIMIT_MAX,
		CONFIG_LAB_RATE_LIMIT_WINDOW_S, DIV_ROUND_UP(wait_ms, MSEC_PER_SEC));

	return r < 0 ? r : 1;
}
```

## src/reading.c
```c
/* The sensor side of /env/temp. A thread reads the sensor every SAMPLE_MS,
 * rejects values that can't be real, and keeps the last good reading plus the
 * counters printed by "soilsense stats". The sensor is whatever the devicetree
 * alias temp-sensor points at (an overlay from sensors/); without one, the
 * Lab 3 simulation runs instead.
 */
#include <math.h>
#include <stdlib.h>
#include <zephyr/kernel.h>
#include <zephyr/device.h>
#include <zephyr/drivers/sensor.h>
#include <zephyr/logging/log.h>
#include <zephyr/random/random.h>
#include <zephyr/shell/shell.h>

#include "app.h"

LOG_MODULE_REGISTER(reading, LOG_LEVEL_INF);

#define SAMPLE_MS     2000
#define T_MIN_C       (-40.0f)
#define T_MAX_C       85.0f   /* exclusive: a DS18B20 reports exactly 85.0 at power-on */
#define MAX_STEP_C    5.0f    /* between two samples; no air or soil warms that fast */
#define STEP_CHECK_MS 10000   /* the step check only applies against a recent value */
#define LOST_AFTER    3       /* consecutive failed reads before the sensor counts as lost */

#if DT_HAS_ALIAS(temp_sensor)
static const struct device *const sensor = DEVICE_DT_GET(DT_ALIAS(temp_sensor));
#endif

static struct k_spinlock lock;
static struct reading last;
static float last_rh = NAN;
static bool log_samples;

static struct {
	uint32_t reads;
	uint32_t failed;
	uint32_t rejected;
	uint32_t in_a_row;
	uint32_t read_us_min;
	uint32_t read_us_max;
	uint64_t read_us_sum;
	int64_t since_ms;
} stats;

struct reading reading_get(void)
{
	struct reading r;

	K_SPINLOCK(&lock) {
		r = last;
	}

	return r;
}

const char *reading_sensor_name(void)
{
#if DT_HAS_ALIAS(temp_sensor)
	return sensor->name;
#else
	return "simulated";
#endif
}

/* Why t can't be a real reading, or NULL if it is plausible */
static const char *implausible(float t, int64_t now, char *buf, size_t size)
{
	if (t < T_MIN_C || t >= T_MAX_C) {
		snprintk(buf, size, "outside %.0f..%.0f C", (double)T_MIN_C, (double)T_MAX_C);
		return buf;
	}
	if (last.valid && now - last.at_ms < STEP_CHECK_MS && fabsf(t - last.t) > MAX_STEP_C) {
		snprintk(buf, size, "jumped %+.1f C in one sample", (double)(t - last.t));
		return buf;
	}

	return NULL;
}

static void check_and_store(float t, float rh, const char *source)
{
	int64_t now = k_uptime_get();
	char buf[40];
	const char *why;

	K_SPINLOCK(&lock) {
		why = implausible(t, now, buf, sizeof(buf));
		if (why == NULL) {
			last.valid = true;
			last.t = t;
			last.at_ms = now;
			last.seq++;
		} else {
			stats.rejected++;
		}
	}

	if (why != NULL) {
		LOG_WRN("Rejected %.2f C from %s: %s", (double)t, source, why);
	} else if (log_samples && !isnan(rh)) {
		LOG_INF("%s: %.2f C, %.1f %%RH", source, (double)t, (double)rh);
	} else if (log_samples) {
		LOG_INF("%s: %.2f C", source, (double)t);
	}
}

#if DT_HAS_ALIAS(temp_sensor)
static void read_sensor(void)
{
	struct sensor_value v, h;
	float rh = NAN;
	uint32_t c0, us, in_a_row = 0;
	int rc;

	c0 = k_cycle_get_32();
	rc = device_is_ready(sensor) ? sensor_sample_fetch(sensor) : -ENODEV;
	us = k_cyc_to_us_floor32(k_cycle_get_32() - c0);
	if (rc == 0) {
		rc = sensor_channel_get(sensor, SENSOR_CHAN_AMBIENT_TEMP, &v);
	}
	if (rc == 0 && sensor_channel_get(sensor, SENSOR_CHAN_HUMIDITY, &h) == 0) {
		rh = sensor_value_to_float(&h);
	}

	K_SPINLOCK(&lock) {
		stats.reads++;
		stats.read_us_sum += us;
		stats.read_us_min = MIN(stats.read_us_min, us);
		stats.read_us_max = MAX(stats.read_us_max, us);
		if (rc < 0) {
			stats.failed++;
			in_a_row = ++stats.in_a_row;
		} else {
			in_a_row = stats.in_a_row;
			stats.in_a_row = 0;
			last_rh = rh;
		}
	}

	if (rc < 0) {
		if (rc == -ENODEV && in_a_row == 1) {
			LOG_ERR("%s was not found at boot; fix the wiring, then reset the board",
				sensor->name);
		} else if (in_a_row < LOST_AFTER) {
			LOG_WRN("Read failed (%d) after %u us", rc, us);
		} else if (in_a_row == LOST_AFTER) {
			LOG_ERR("Sensor lost: %u failed reads in a row; retrying every %d s",
				in_a_row, SAMPLE_MS / MSEC_PER_SEC);
		}
		return;
	}

	if (in_a_row >= LOST_AFTER) {
		LOG_INF("Sensor back after %u failed reads", in_a_row);
	}
	check_and_store(sensor_value_to_float(&v), rh, sensor->name);
}
#else
/* Lab 3's simulated sensor: 24.5 °C ± 1 °C over 60 s, plus ±0.1 °C noise */
static void read_sensor(void)
{
	float noise = (int32_t)(sys_rand32_get() % 201 - 100) / 1000.0f;
	float phase = (float)(k_uptime_get() % 60000) / 60000.0f;

	K_SPINLOCK(&lock) {
		stats.reads++;
	}
	check_and_store(24.5f + sinf(2.0f * 3.14159265f * phase) + noise, NAN, "simulated");
}
#endif

static void reset_stats(void)
{
	K_SPINLOCK(&lock) {
		memset(&stats, 0, sizeof(stats));
		stats.read_us_min = UINT32_MAX;
		stats.since_ms = k_uptime_get();
	}
}

static void sampler(void *p1, void *p2, void *p3)
{
	int64_t next = k_uptime_get();

	reset_stats();
	LOG_INF("Reading %s every %d s", reading_sensor_name(), SAMPLE_MS / MSEC_PER_SEC);

	while (true) {
		watchdog_feed_sampler();
		read_sensor();
		next += SAMPLE_MS;
		k_sleep(K_TIMEOUT_ABS_MS(next));
	}
}

/* Below the OpenThread thread (8): the radio may interrupt a sensor read */
K_THREAD_DEFINE(sampler_tid, 2048, sampler, NULL, NULL, NULL, 10, 0, 0);

static int cmd_stats(const struct shell *sh, size_t argc, char **argv)
{
	struct reading r;
	float rh;
	typeof(stats) s;
	int64_t now = k_uptime_get();

	K_SPINLOCK(&lock) {
		r = last;
		rh = last_rh;
		s = stats;
	}

	shell_print(sh, "sensor:    %s", reading_sensor_name());
	if (r.valid) {
		shell_print(sh, "last good: %.2f C, %lld s ago", (double)r.t,
			    (now - r.at_ms) / MSEC_PER_SEC);
	} else {
		shell_print(sh, "last good: none yet");
	}
	if (!isnan(rh)) {
		shell_print(sh, "humidity:  %.1f %%RH", (double)rh);
	}
	shell_print(sh, "reads:     %u in %lld s: %u failed (%.1f %%), %u rejected", s.reads,
		    (now - s.since_ms) / MSEC_PER_SEC, s.failed,
		    s.reads ? 100.0 * s.failed / s.reads : 0.0, s.rejected);
	if (s.reads > 0 && s.read_us_max > 0) {
		shell_print(sh, "read time: min %u us, avg %llu us, max %u us", s.read_us_min,
			    s.read_us_sum / s.reads, s.read_us_max);
	}
	if (s.in_a_row > 0) {
		shell_print(sh, "now:       %u failed reads in a row", s.in_a_row);
	}

	return 0;
}

static int cmd_reset(const struct shell *sh, size_t argc, char **argv)
{
	reset_stats();
	shell_print(sh, "Counters zeroed");
	return 0;
}

static int cmd_log(const struct shell *sh, size_t argc, char **argv)
{
	if (strcmp(argv[1], "on") == 0) {
		log_samples = true;
	} else if (strcmp(argv[1], "off") == 0) {
		log_samples = false;
	} else {
		shell_error(sh, "Usage: soilsense log on|off");
		return -EINVAL;
	}

	return 0;
}

static int cmd_inject(const struct shell *sh, size_t argc, char **argv)
{
	char *end;
	float t = strtof(argv[1], &end);

	if (end == argv[1] || *end != '\0') {
		shell_error(sh, "Usage: soilsense inject <degrees C>");
		return -EINVAL;
	}

	check_and_store(t, NAN, "inject");
	return 0;
}

SHELL_STATIC_SUBCMD_SET_CREATE(soilsense_cmds,
	SHELL_CMD_ARG(stats, NULL, "Last reading, failure counts and read time", cmd_stats, 1, 0),
	SHELL_CMD_ARG(reset, NULL, "Zero the counters", cmd_reset, 1, 0),
	SHELL_CMD_ARG(log, NULL, "Print every reading: log on|off", cmd_log, 2, 0),
	SHELL_CMD_ARG(inject, NULL, "Pass one made-up reading through the checks: inject <C>",
		      cmd_inject, 2, 0),
	SHELL_SUBCMD_SET_END);

SHELL_CMD_REGISTER(soilsense, &soilsense_cmds, "SoilSense sensor tools", NULL);
```

## src/valve.c
```c
/* /act/valve: irrigation valve (the board's LED), state as CBOR {"v": 0|1}.
 * PUT sets it, GET reads it. The OpenThread shell can't send binary payloads,
 * so a request without a Content-Format may carry the text "0" or "1" instead.
 *
 * Fail-safe: water flowing is the dangerous state. With the valve open and no
 * neighbour at all (detached, or a router left alone) for CONFIG_LAB_FAILSAFE_S
 * seconds, the valve closes itself.
 */
#include <zephyr/kernel.h>
#include <zephyr/logging/log.h>
#include <zephyr/net/coap_service.h>
#include <zephyr/sys/util.h>
#include <zcbor_decode.h>
#include <zcbor_encode.h>
#include <openthread.h>
#include <openthread/thread.h>

#include "app.h"

LOG_MODULE_REGISTER(valve, LOG_LEVEL_INF);

static atomic_t valve_open;

/* A1 61 76 0X = {"v": X} */
static size_t encode_state(bool open, uint8_t *buf, size_t size)
{
	ZCBOR_STATE_E(zs, 1, buf, size, 1);

	if (!(zcbor_map_start_encode(zs, 1) && zcbor_tstr_put_lit(zs, "v") &&
	      zcbor_uint32_put(zs, open) && zcbor_map_end_encode(zs, 1))) {
		return 0;
	}

	return zs->payload - buf;
}

static int decode_command(const struct coap_packet *req, bool *open)
{
	uint16_t len;
	const uint8_t *p = coap_packet_get_payload(req, &len);
	int format = coap_get_option_int(req, COAP_OPTION_CONTENT_FORMAT);

	if (p == NULL || len == 0) {
		return -EINVAL;
	}

	if (format == COAP_CONTENT_FORMAT_APP_CBOR) {
		ZCBOR_STATE_D(zs, 1, p, len, 1, 0);
		uint32_t v;

		if (!(zcbor_map_start_decode(zs) && zcbor_tstr_expect_lit(zs, "v") &&
		      zcbor_uint32_decode(zs, &v) && zcbor_map_end_decode(zs)) || v > 1) {
			return -EINVAL;
		}
		*open = v;
		return 0;
	}

	if ((format < 0 || format == COAP_CONTENT_FORMAT_TEXT_PLAIN) && len == 1 &&
	    (p[0] == '0' || p[0] == '1')) {
		*open = p[0] == '1';
		return 0;
	}

	return -EINVAL;
}

static int reply_state(struct coap_resource *res, const struct coap_packet *req,
		       struct net_sockaddr *addr, net_socklen_t addr_len, uint8_t code,
		       uint16_t *size)
{
	uint8_t buf[CONFIG_COAP_SERVER_MESSAGE_SIZE];
	uint8_t cbor[4];
	size_t n = encode_state(atomic_get(&valve_open), cbor, sizeof(cbor));
	struct coap_packet rsp;
	int r;

	r = response_init(&rsp, buf, sizeof(buf), req, code);
	if (r == 0) {
		r = coap_append_option_int(&rsp, COAP_OPTION_CONTENT_FORMAT,
					   COAP_CONTENT_FORMAT_APP_CBOR);
	}
	if (r == 0) {
		r = coap_packet_append_payload_marker(&rsp);
	}
	if (r == 0) {
		r = coap_packet_append_payload(&rsp, cbor, n);
	}
	if (r < 0) {
		return r;
	}
	*size = rsp.offset;

	return coap_resource_send(res, &rsp, addr, addr_len, NULL);
}

static int valve_put(struct coap_resource *res, struct coap_packet *req,
		     struct net_sockaddr *addr, net_socklen_t addr_len)
{
	char peer[NET_IPV6_ADDR_LEN];
	bool was_open = atomic_get(&valve_open);
	bool open;
	uint16_t size = 0;
	int r = rate_limit_check(res, req, addr, addr_len);

	if (r != 0) {
		return r < 0 ? r : 0;
	}
	peer_str(addr, peer, sizeof(peer));

	if (decode_command(req, &open) < 0) {
		LOG_WRN("PUT /act/valve from %s: payload not {\"v\": 0|1} or \"0\"/\"1\" -> 4.00",
			peer);
		/* A positive return makes the server ACK a CON request with this code */
		return COAP_RESPONSE_CODE_BAD_REQUEST;
	}

	atomic_set(&valve_open, open);
	led_show_valve(open);
	r = reply_state(res, req, addr, addr_len, COAP_RESPONSE_CODE_CHANGED, &size);
	LOG_INF("PUT /act/valve from %s (%s): %s%s -> 2.04, CoAP %u B, request %u B", peer,
		coap_header_get_type(req) == COAP_TYPE_CON ? "CON" : "NON",
		open ? "OPEN" : "CLOSED", open == was_open ? ", no change" : "", size,
		req->max_len);

	return r;
}

static int valve_get(struct coap_resource *res, struct coap_packet *req,
		     struct net_sockaddr *addr, net_socklen_t addr_len)
{
	char peer[NET_IPV6_ADDR_LEN];
	uint16_t size = 0;
	int r = rate_limit_check(res, req, addr, addr_len);

	if (r != 0) {
		return r < 0 ? r : 0;
	}
	r = reply_state(res, req, addr, addr_len, COAP_RESPONSE_CODE_CONTENT, &size);
	LOG_INF("GET /act/valve from %s: %s -> 2.05, CoAP %u B, request %u B",
		peer_str(addr, peer, sizeof(peer)), atomic_get(&valve_open) ? "OPEN" : "CLOSED", size,
		req->max_len);

	return r;
}

static const char *const valve_path[] = { "act", "valve", NULL };
COAP_RESOURCE_DEFINE(valve, soilsense, {
	.get = valve_get,
	.put = valve_put,
	.path = valve_path,
});

/* No neighbour at all: detached or disabled, or a router whose every link died */
static bool isolated(void)
{
	otInstance *ot = openthread_get_default_instance();
	otNeighborInfoIterator it = OT_NEIGHBOR_INFO_ITERATOR_INIT;
	otNeighborInfo info;
	bool alone;

	openthread_mutex_lock();
	switch (otThreadGetDeviceRole(ot)) {
	case OT_DEVICE_ROLE_CHILD:
		alone = false;
		break;
	case OT_DEVICE_ROLE_ROUTER:
	case OT_DEVICE_ROLE_LEADER:
		alone = otThreadGetNextNeighborInfo(ot, &it, &info) != OT_ERROR_NONE;
		break;
	default:
		alone = true;
	}
	openthread_mutex_unlock();

	return alone;
}

static void failsafe(struct k_work *work)
{
	static int64_t alone_since_ms;
	int64_t now = k_uptime_get();

	if (!isolated()) {
		alone_since_ms = 0;
	} else if (alone_since_ms == 0) {
		alone_since_ms = now;
	} else if (atomic_get(&valve_open) &&
		   now - alone_since_ms >= CONFIG_LAB_FAILSAFE_S * MSEC_PER_SEC) {
		atomic_set(&valve_open, false);
		led_show_valve(false);
		LOG_WRN("FAILSAFE: no neighbour for %lld s with the valve open: closing it",
			(now - alone_since_ms) / MSEC_PER_SEC);
	}
	k_work_schedule(k_work_delayable_from_work(work), K_SECONDS(1));
}

static K_WORK_DELAYABLE_DEFINE(failsafe_work, failsafe);

static int failsafe_init(void)
{
	k_work_schedule(&failsafe_work, K_SECONDS(1));
	return 0;
}

SYS_INIT(failsafe_init, APPLICATION, CONFIG_APPLICATION_INIT_PRIORITY);
```
