## CMakeLists.txt
```
cmake_minimum_required(VERSION 3.20.0)
find_package(Zephyr REQUIRED HINTS $ENV{ZEPHYR_BASE})
project(lab2_mesh)

target_sources(app PRIVATE src/main.c)
```

## prj.conf
```kconfig
CONFIG_LOG=y
CONFIG_MAIN_STACK_SIZE=4096

# Networking over 802.15.4 (Interface Capability)
CONFIG_NETWORKING=y
CONFIG_NET_L2_OPENTHREAD=y
# Without this every board in the room auto-joins the same default network on
# channel 11 at boot.
CONFIG_OPENTHREAD_MANUAL_START=y
CONFIG_OPENTHREAD_PING_SENDER=y

# Settings backend for the Thread dataset
CONFIG_NVS=y

# OpenThread CLI as "ot <command>"
CONFIG_SHELL=y
CONFIG_NET_SHELL=y
CONFIG_OPENTHREAD_SHELL=y
# "ot dataset set active <hex>" is ~240 characters; the defaults truncate a paste.
CONFIG_SHELL_CMD_BUFF_SIZE=512
CONFIG_SHELL_BACKEND_SERIAL_RX_RING_BUFFER_SIZE=512

# "ot macfilter" shapes the topology on a desk (Lab 2, Part 3)
CONFIG_OPENTHREAD_MAC_FILTER=y

# Addressable RGB LED shows the Thread role
CONFIG_LED_STRIP=y
```

## usb_console.conf
```kconfig
# The USB port re-enumerates on reset; wait for the host so boot messages aren't lost
CONFIG_BOOT_DELAY=1500
```

## src/main.c
```c
#include <zephyr/kernel.h>
#include <zephyr/logging/log.h>
#include <zephyr/drivers/led_strip.h>
#include <openthread.h>
#include <openthread/thread.h>

LOG_MODULE_REGISTER(lab2_mesh, LOG_LEVEL_INF);

static const struct device *const strip = DEVICE_DT_GET(DT_ALIAS(led_strip));

/* Thread role → LED colour, indexed by otDeviceRole */
static const struct led_rgb role_colors[] = {
	[OT_DEVICE_ROLE_DISABLED] = { .r = 0x00, .g = 0x00, .b = 0x00 },
	[OT_DEVICE_ROLE_DETACHED] = { .r = 0x20, .g = 0x00, .b = 0x00 },
	[OT_DEVICE_ROLE_CHILD]    = { .r = 0x20, .g = 0x18, .b = 0x00 },
	[OT_DEVICE_ROLE_ROUTER]   = { .r = 0x00, .g = 0x20, .b = 0x00 },
	[OT_DEVICE_ROLE_LEADER]   = { .r = 0x00, .g = 0x00, .b = 0x20 },
};

static atomic_t role = ATOMIC_INIT(OT_DEVICE_ROLE_DISABLED);

/* The OpenThread callback runs with the stack locked; drive the LED from the system workqueue */
static void led_work_handler(struct k_work *work)
{
	struct led_rgb pixel = role_colors[atomic_get(&role)];

	if (led_strip_update_rgb(strip, &pixel, 1) != 0) {
		LOG_ERR("Failed to drive LED");
	}
}

static K_WORK_DEFINE(led_work, led_work_handler);

static void ot_state_changed(otChangedFlags flags, void *user_data)
{
	if (!(flags & OT_CHANGED_THREAD_ROLE)) {
		return;
	}

	otDeviceRole r = otThreadGetDeviceRole(openthread_get_default_instance());

	LOG_INF("Thread role: %s", otThreadDeviceRoleToString(r));
	atomic_set(&role, r);
	k_work_submit(&led_work);
}

static struct openthread_state_changed_callback ot_state_cb = {
	.otCallback = ot_state_changed,
};

int main(void)
{
	if (!device_is_ready(strip)) {
		LOG_ERR("LED strip device not ready");
	} else {
		k_work_submit(&led_work);
		openthread_state_changed_callback_register(&ot_state_cb);
	}

	LOG_INF("Thread mesh node ready. OpenThread commands start with \"ot\".");

	return 0;
}
```
