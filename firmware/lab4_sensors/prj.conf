## CMakeLists.txt
```
cmake_minimum_required(VERSION 3.20.0)
find_package(Zephyr REQUIRED HINTS $ENV{ZEPHYR_BASE})
project(lab4_sensors)

target_sources(app PRIVATE src/main.c src/reading.c src/env_temp.c src/valve.c)

# Collect the CoAP resources of the "soilsense" service into one list
zephyr_linker_sources(DATA_SECTIONS sections-ram.ld)
zephyr_iterable_section(NAME coap_resource_soilsense GROUP DATA_REGION ${XIP_ALIGN_WITH_INPUT})
```

## Kconfig
```
# BMP280: measure on request and sleep in between, instead of sampling
# continuously. Declared before Kconfig.zephyr so this default comes first.
choice BME280_MODE
	default BME280_MODE_FORCED
endchoice

source "Kconfig.zephyr"
```

## prj.conf
```kconfig
CONFIG_LOG=y
CONFIG_MAIN_STACK_SIZE=4096
CONFIG_CBPRINTF_FP_SUPPORT=y

# Networking over 802.15.4 (Interface Capability)
CONFIG_NETWORKING=y
CONFIG_NET_L2_OPENTHREAD=y
CONFIG_NET_UDP=y
# Without this every board in the room auto-joins the same default network on
# channel 11 at boot.
CONFIG_OPENTHREAD_MANUAL_START=y
CONFIG_OPENTHREAD_PING_SENDER=y
# Lab 5: build a global address from the prefix a Border Router advertises.
CONFIG_OPENTHREAD_SLAAC=y
# The 0 dBm default barely reaches past a few centimetres on these boards.
CONFIG_OPENTHREAD_DEFAULT_TX_POWER=20

# Settings backend for the Thread dataset
CONFIG_NVS=y

# OpenThread CLI as "ot <command>", including the "ot coap" client
CONFIG_SHELL=y
CONFIG_NET_SHELL=y
CONFIG_OPENTHREAD_SHELL=y
CONFIG_OPENTHREAD_COAP=y
CONFIG_OPENTHREAD_COAP_OBSERVE=y
# "ot dataset set active <hex>" is ~240 characters; the defaults truncate a paste.
CONFIG_SHELL_CMD_BUFF_SIZE=512
CONFIG_SHELL_BACKEND_SERIAL_RX_RING_BUFFER_SIZE=512
CONFIG_OPENTHREAD_MAC_FILTER=y

# CoAP server: /env/temp and /act/valve on UDP 5683
CONFIG_COAP=y
CONFIG_COAP_SERVER=y
CONFIG_COAP_SERVICE_OBSERVERS=4

# CBOR payloads; canonical = definite-length maps (A1, not BF ... FF)
CONFIG_ZCBOR=y
CONFIG_ZCBOR_CANONICAL=y

# Sensor drivers; the overlay in sensors/ picks the one that is built
CONFIG_SENSOR=y
CONFIG_I2C=y
CONFIG_W1=y

# RGB LED: Thread role, or white while the valve is open
CONFIG_LED_STRIP=y
```

## usb_console.overlay
```dts
/* Console and shell on the ESP32-C6's native USB-Serial-JTAG port, for boards
 * without a USB-UART bridge (ESP32-C6 Super Mini) or the DevKitC's "USB" port.
 */
&usb_serial {
	status = "okay";
};

/ {
	chosen {
		zephyr,console = &usb_serial;
		zephyr,shell-uart = &usb_serial;
	};
};
```

## src/main.c
```c
#include <zephyr/kernel.h>
#include <zephyr/logging/log.h>
#include <zephyr/drivers/led_strip.h>
#include <zephyr/net/coap_service.h>
#include <openthread.h>
#include <openthread/thread.h>

#include "app.h"

LOG_MODULE_REGISTER(lab4_sensors, LOG_LEVEL_INF);

static uint16_t coap_port = 5683;

/* Starts at boot on every board. On the board where you run "ot coap start",
 * OpenThread binds port 5683 itself and keeps the traffic, so that board acts
 * as the client and this server stays silent.
 */
COAP_SERVICE_DEFINE(soilsense, NULL, &coap_port, COAP_SERVICE_AUTOSTART);

static const struct device *const strip = DEVICE_DT_GET(DT_ALIAS(led_strip));

/* Thread role → LED colour, indexed by otDeviceRole */
static const struct led_rgb role_colors[] = {
	[OT_DEVICE_ROLE_DISABLED] = { .r = 0x00, .g = 0x00, .b = 0x00 },
	[OT_DEVICE_ROLE_DETACHED] = { .r = 0x20, .g = 0x00, .b = 0x00 },
	[OT_DEVICE_ROLE_CHILD]    = { .r = 0x20, .g = 0x18, .b = 0x00 },
	[OT_DEVICE_ROLE_ROUTER]   = { .r = 0x00, .g = 0x20, .b = 0x00 },
	[OT_DEVICE_ROLE_LEADER]   = { .r = 0x00, .g = 0x00, .b = 0x20 },
};
static const struct led_rgb valve_open_color = { .r = 0x30, .g = 0x30, .b = 0x30 };

static atomic_t role = ATOMIC_INIT(OT_DEVICE_ROLE_DISABLED);
static atomic_t valve_open;

/* The OpenThread callback runs with the stack locked; drive the LED from the system workqueue */
static void led_work_handler(struct k_work *work)
{
	struct led_rgb pixel = atomic_get(&valve_open) ? valve_open_color
						       : role_colors[atomic_get(&role)];

	if (led_strip_update_rgb(strip, &pixel, 1) != 0) {
		LOG_ERR("Failed to drive LED");
	}
}

static K_WORK_DEFINE(led_work, led_work_handler);

void led_show_valve(bool open)
{
	atomic_set(&valve_open, open);
	k_work_submit(&led_work);
}

static void ot_state_changed(otChangedFlags flags, void *user_data)
{
	if (!(flags & OT_CHANGED_THREAD_ROLE)) {
		return;
	}

	otDeviceRole r = otThreadGetDeviceRole(openthread_get_default_instance());

	LOG_INF("Thread role: %s", otThreadDeviceRoleToString(r));
	atomic_set(&role, r);
	k_work_submit(&led_work);
}

static struct openthread_state_changed_callback ot_state_cb = {
	.otCallback = ot_state_changed,
};

int response_init(struct coap_packet *rsp, uint8_t *buf, size_t size,
		  const struct coap_packet *req, uint8_t code)
{
	uint8_t token[COAP_TOKEN_MAX_LEN];
	uint8_t tkl = coap_header_get_token(req, token);
	bool con = coap_header_get_type(req) == COAP_TYPE_CON;

	return coap_packet_init(rsp, buf, size, COAP_VERSION_1,
				con ? COAP_TYPE_ACK : COAP_TYPE_NON_CON, tkl, token, code,
				con ? coap_header_get_id(req) : coap_next_id());
}

const char *peer_str(const struct net_sockaddr *addr, char *buf, size_t size)
{
	return net_addr_ntop(NET_AF_INET6, &net_sin6(addr)->sin6_addr, buf, size);
}

int main(void)
{
	if (!device_is_ready(strip)) {
		LOG_ERR("LED strip device not ready");
	} else {
		k_work_submit(&led_work);
		openthread_state_changed_callback_register(&ot_state_cb);
	}

	LOG_INF("SoilSense node ready: CoAP /env/temp (%s) and /act/valve on UDP %u. "
		"OpenThread commands start with \"ot\".", reading_sensor_name(), coap_port);

	return 0;
}
```

## src/app.h
```c
#ifndef APP_H_
#define APP_H_

#include <stdbool.h>
#include <stdint.h>
#include <zephyr/net/coap.h>

void led_show_valve(bool open);

/* Start a response to req: piggybacked ACK for a CON request, NON otherwise */
int response_init(struct coap_packet *rsp, uint8_t *buf, size_t size,
		  const struct coap_packet *req, uint8_t code);

/* Peer address as text, for logs */
const char *peer_str(const struct net_sockaddr *addr, char *buf, size_t size);

/* Last reading that passed the plausibility checks */
struct reading {
	bool valid;     /* false until the first accepted reading */
	float t;        /* °C */
	int64_t at_ms;  /* uptime when it was taken */
	uint32_t seq;   /* increments with every accepted reading */
};

struct reading reading_get(void);

/* Name of the sensor in the devicetree, or "simulated" */
const char *reading_sensor_name(void);

#endif
```

## src/env_temp.c
```c
/* /env/temp: temperature as CBOR {"t": float16}, readable with GET and pushed
 * to observers (RFC 7641) when it moves more than THRESHOLD_C, or every
 * HEARTBEAT_S seconds if it doesn't. A reading is served for at most MAX_AGE_S
 * after it was taken: Max-Age counts down as it ages, and once no accepted
 * reading is that recent, GET answers 5.03 and every observation ends with a
 * 5.03 notification.
 */
#include <math.h>
#include <zephyr/kernel.h>
#include <zephyr/logging/log.h>
#include <zephyr/net/coap_service.h>
#include <zephyr/sys/util.h>
#include <zcbor_encode.h>

#include "app.h"

LOG_MODULE_REGISTER(env_temp, LOG_LEVEL_INF);

#define THRESHOLD_C 0.5f
#define HEARTBEAT_S 45
#define MAX_AGE_S   60
#define RETRY_S     10  /* Max-Age of a 5.03: when the client may ask again */

static const char unavailable_msg[] = "no fresh reading";

static float last_notified_c;
static int64_t last_notify_ms;
static uint8_t notify_type = COAP_TYPE_NON_CON;
static bool fresh, been_fresh;
static uint32_t n_threshold, n_heartbeat;

/* Observations being ended with a 5.03, collected while notifying */
static bool ending;
static struct {
	uint8_t token[COAP_TOKEN_MAX_LEN];
	uint8_t tkl;
} ended[CONFIG_COAP_SERVICE_OBSERVERS];
static int n_ended;

/* Seconds the reading stays fresh; 0 once it is too old to serve */
static uint32_t freshness_s(const struct reading *r, int64_t now)
{
	int64_t age_s;

	if (!r->valid) {
		return 0;
	}
	age_s = (now - r->at_ms) / MSEC_PER_SEC;

	return age_s < MAX_AGE_S ? MAX_AGE_S - age_s : 0;
}

/* A1 61 74 F9 hh ll = {"t": <half-precision float>} */
static size_t encode_reading(float t, uint8_t *buf, size_t size)
{
	ZCBOR_STATE_E(zs, 1, buf, size, 1);

	if (!(zcbor_map_start_encode(zs, 1) && zcbor_tstr_put_lit(zs, "t") &&
	      zcbor_float16_put(zs, t) && zcbor_map_end_encode(zs, 1))) {
		return 0;
	}

	return zs->payload - buf;
}

/* Options must be appended in option-number order: Observe (6),
 * Content-Format (12), Max-Age (14).
 */
static int build_reading(struct coap_packet *pkt, bool observe, int seq, const uint8_t *cbor,
			 size_t n, uint32_t max_age)
{
	int r = 0;

	if (n == 0) {
		return -ENOMEM;
	}
	if (observe) {
		r = coap_append_option_int(pkt, COAP_OPTION_OBSERVE, seq);
	}
	if (r == 0) {
		r = coap_append_option_int(pkt, COAP_OPTION_CONTENT_FORMAT,
					   COAP_CONTENT_FORMAT_APP_CBOR);
	}
	if (r == 0) {
		r = coap_append_option_int(pkt, COAP_OPTION_MAX_AGE, max_age);
	}
	if (r == 0) {
		r = coap_packet_append_payload_marker(pkt);
	}
	if (r == 0) {
		r = coap_packet_append_payload(pkt, cbor, n);
	}

	return r;
}

/* 5.03 with Max-Age = when to retry, and a diagnostic text payload. Error
 * responses carry no Observe option (RFC 7641 §4.2), which is what ends an
 * observation on the client.
 */
static int build_unavailable(struct coap_packet *pkt)
{
	int r = coap_append_option_int(pkt, COAP_OPTION_MAX_AGE, RETRY_S);

	if (r == 0) {
		r = coap_packet_append_payload_marker(pkt);
	}
	if (r == 0) {
		r = coap_packet_append_payload(pkt, unavailable_msg, sizeof(unavailable_msg) - 1);
	}

	return r;
}

static int env_temp_get(struct coap_resource *res, struct coap_packet *req,
			struct net_sockaddr *addr, net_socklen_t addr_len)
{
	uint8_t buf[CONFIG_COAP_SERVER_MESSAGE_SIZE];
	struct coap_packet rsp;
	char peer[NET_IPV6_ADDR_LEN];
	uint8_t cbor[8];
	size_t n;
	char hex[2 * sizeof(cbor) + 1];
	struct reading reading = reading_get();
	int64_t now = k_uptime_get();
	uint32_t max_age = freshness_s(&reading, now);
	int obs, r;

	peer_str(addr, peer, sizeof(peer));

	if (max_age == 0) {
		r = response_init(&rsp, buf, sizeof(buf), req,
				  COAP_RESPONSE_CODE_SERVICE_UNAVAILABLE);
		if (r == 0) {
			r = build_unavailable(&rsp);
		}
		if (r < 0) {
			return r;
		}
		LOG_WRN("GET /env/temp from %s: 5.03, no reading younger than %d s, retry in %d s",
			peer, MAX_AGE_S, RETRY_S);
		return coap_resource_send(res, &rsp, addr, addr_len, NULL);
	}

	obs = coap_resource_parse_observe(res, req, addr);
	n = encode_reading(reading.t, cbor, sizeof(cbor));
	r = response_init(&rsp, buf, sizeof(buf), req, COAP_RESPONSE_CODE_CONTENT);
	if (r == 0) {
		r = build_reading(&rsp, obs == 0, res->age, cbor, n, max_age);
	}
	if (r < 0) {
		return r;
	}

	if (obs == 0) {
		/* Count the next notification from this reading */
		last_notified_c = reading.t;
		last_notify_ms = now;
	}

	bin2hex(cbor, n, hex, sizeof(hex));
	LOG_INF("GET /env/temp from %s%s: 2.05, %.2f C, %llds old, Max-Age %u (CBOR %s)", peer,
		obs == 0 ? " (observe)" : obs == 1 ? " (cancel)" : "", (double)reading.t,
		(now - reading.at_ms) / MSEC_PER_SEC, max_age, hex);

	return coap_resource_send(res, &rsp, addr, addr_len, NULL);
}

static void env_temp_notify(struct coap_resource *res, struct coap_observer *obs)
{
	uint8_t buf[CONFIG_COAP_SERVER_MESSAGE_SIZE];
	struct coap_packet pkt;
	struct reading reading = reading_get();
	uint8_t code = ending ? COAP_RESPONSE_CODE_SERVICE_UNAVAILABLE
			      : COAP_RESPONSE_CODE_CONTENT;
	int r;

	r = coap_packet_init(&pkt, buf, sizeof(buf), COAP_VERSION_1, notify_type, obs->tkl,
			     obs->token, code, coap_next_id());
	if (r == 0 && ending) {
		r = build_unavailable(&pkt);
		if (n_ended < ARRAY_SIZE(ended)) {
			memcpy(ended[n_ended].token, obs->token, obs->tkl);
			ended[n_ended++].tkl = obs->tkl;
		}
	} else if (r == 0) {
		uint8_t cbor[8];
		size_t n = encode_reading(reading.t, cbor, sizeof(cbor));

		r = build_reading(&pkt, true, res->age, cbor, n,
				  freshness_s(&reading, k_uptime_get()));
	}
	if (r == 0) {
		r = coap_resource_send(res, &pkt, net_sad(&obs->addr),
				       net_family2size(obs->addr.ss_family), NULL);
	}
	if (r < 0) {
		LOG_WRN("Notification failed (%d)", r);
	}
}

static const char *const env_temp_path[] = { "env", "temp", NULL };
COAP_RESOURCE_DEFINE(env_temp, soilsense, {
	.get = env_temp_get,
	.path = env_temp_path,
	.notify = env_temp_notify,
});

/* Tell every observer the data is gone (CON, so a vanished one is noticed),
 * then forget them: a client re-registers once readings are fresh again.
 */
static void end_observations(void)
{
	ending = true;
	notify_type = COAP_TYPE_CON;
	n_ended = 0;
	coap_resource_notify(&env_temp);
	ending = false;

	for (int i = 0; i < n_ended; i++) {
		coap_resource_remove_observer_by_token(&env_temp, ended[i].token, ended[i].tkl);
	}
	LOG_WRN("No reading younger than %d s: GET now answers 5.03; %d observation(s) ended",
		MAX_AGE_S, n_ended);
}

/* Observe policy, once a second: notify on a change or a heartbeat while the
 * data is fresh, and end the observations when it stops being fresh.
 */
static void policy(struct k_work *work)
{
	struct reading reading = reading_get();
	int64_t now = k_uptime_get();
	uint32_t max_age = freshness_s(&reading, now);
	float delta;
	bool threshold, heartbeat;

	if ((max_age > 0) != fresh) {
		fresh = max_age > 0;
		if (fresh) {
			if (been_fresh) {
				LOG_INF("Fresh readings again: GET answers 2.05; observers must "
					"register again");
			}
			been_fresh = true;
			last_notified_c = reading.t;
			last_notify_ms = now;
		} else {
			end_observations();
		}
	}

	if (fresh && !sys_slist_is_empty(&env_temp.observers)) {
		delta = fabsf(reading.t - last_notified_c);
		threshold = delta > THRESHOLD_C;
		heartbeat = now - last_notify_ms >= HEARTBEAT_S * MSEC_PER_SEC;

		if (threshold || heartbeat) {
			/* Heartbeats go CON: if the observer is gone, the retransmissions
			 * fail and the server drops it (RFC 7641 §4.5).
			 */
			notify_type = threshold ? COAP_TYPE_NON_CON : COAP_TYPE_CON;
			if (threshold) {
				n_threshold++;
			} else {
				n_heartbeat++;
			}
			LOG_INF("notify (%s, %s): T=%.2f C, delta=%.2f C, %llds since last, "
				"reading %llds old [threshold %u, heartbeat %u]",
				threshold ? "threshold" : "heartbeat", threshold ? "NON" : "CON",
				(double)reading.t, (double)delta,
				(now - last_notify_ms) / MSEC_PER_SEC,
				(now - reading.at_ms) / MSEC_PER_SEC, n_threshold, n_heartbeat);
			last_notified_c = reading.t;
			last_notify_ms = now;
			coap_resource_notify(&env_temp);
		}
	}

	k_work_schedule(k_work_delayable_from_work(work), K_SECONDS(1));
}

static K_WORK_DELAYABLE_DEFINE(policy_work, policy);

static int env_temp_init(void)
{
	last_notify_ms = k_uptime_get();
	k_work_schedule(&policy_work, K_SECONDS(1));
	return 0;
}

SYS_INIT(env_temp_init, APPLICATION, CONFIG_APPLICATION_INIT_PRIORITY);
```

## src/valve.c
```c
/* /act/valve: irrigation valve (the board's LED), state as CBOR {"v": 0|1}.
 * PUT sets it, GET reads it. The OpenThread shell can't send binary payloads,
 * so a request without a Content-Format may carry the text "0" or "1" instead.
 */
#include <zephyr/kernel.h>
#include <zephyr/logging/log.h>
#include <zephyr/net/coap_service.h>
#include <zephyr/sys/util.h>
#include <zcbor_decode.h>
#include <zcbor_encode.h>

#include "app.h"

LOG_MODULE_REGISTER(valve, LOG_LEVEL_INF);

static bool valve_open;

/* A1 61 76 0X = {"v": X} */
static size_t encode_state(bool open, uint8_t *buf, size_t size)
{
	ZCBOR_STATE_E(zs, 1, buf, size, 1);

	if (!(zcbor_map_start_encode(zs, 1) && zcbor_tstr_put_lit(zs, "v") &&
	      zcbor_uint32_put(zs, open) && zcbor_map_end_encode(zs, 1))) {
		return 0;
	}

	return zs->payload - buf;
}

static int decode_command(const struct coap_packet *req, bool *open)
{
	uint16_t len;
	const uint8_t *p = coap_packet_get_payload(req, &len);
	int format = coap_get_option_int(req, COAP_OPTION_CONTENT_FORMAT);

	if (p == NULL || len == 0) {
		return -EINVAL;
	}

	if (format == COAP_CONTENT_FORMAT_APP_CBOR) {
		ZCBOR_STATE_D(zs, 1, p, len, 1, 0);
		uint32_t v;

		if (!(zcbor_map_start_decode(zs) && zcbor_tstr_expect_lit(zs, "v") &&
		      zcbor_uint32_decode(zs, &v) && zcbor_map_end_decode(zs)) || v > 1) {
			return -EINVAL;
		}
		*open = v;
		return 0;
	}

	if ((format < 0 || format == COAP_CONTENT_FORMAT_TEXT_PLAIN) && len == 1 &&
	    (p[0] == '0' || p[0] == '1')) {
		*open = p[0] == '1';
		return 0;
	}

	return -EINVAL;
}

static int reply_state(struct coap_resource *res, const struct coap_packet *req,
		       struct net_sockaddr *addr, net_socklen_t addr_len, uint8_t code)
{
	uint8_t buf[CONFIG_COAP_SERVER_MESSAGE_SIZE];
	uint8_t cbor[4];
	size_t n = encode_state(valve_open, cbor, sizeof(cbor));
	struct coap_packet rsp;
	int r;

	r = response_init(&rsp, buf, sizeof(buf), req, code);
	if (r == 0) {
		r = coap_append_option_int(&rsp, COAP_OPTION_CONTENT_FORMAT,
					   COAP_CONTENT_FORMAT_APP_CBOR);
	}
	if (r == 0) {
		r = coap_packet_append_payload_marker(&rsp);
	}
	if (r == 0) {
		r = coap_packet_append_payload(&rsp, cbor, n);
	}
	if (r < 0) {
		return r;
	}

	return coap_resource_send(res, &rsp, addr, addr_len, NULL);
}

static int valve_put(struct coap_resource *res, struct coap_packet *req,
		     struct net_sockaddr *addr, net_socklen_t addr_len)
{
	char peer[NET_IPV6_ADDR_LEN];
	bool was_open = valve_open;
	bool open;

	peer_str(addr, peer, sizeof(peer));

	if (decode_command(req, &open) < 0) {
		LOG_WRN("PUT /act/valve from %s: payload not {\"v\": 0|1} or \"0\"/\"1\" -> 4.00",
			peer);
		/* A positive return makes the server ACK a CON request with this code */
		return COAP_RESPONSE_CODE_BAD_REQUEST;
	}

	valve_open = open;
	led_show_valve(open);
	LOG_INF("PUT /act/valve from %s (%s): %s%s -> 2.04", peer,
		coap_header_get_type(req) == COAP_TYPE_CON ? "CON" : "NON",
		open ? "OPEN" : "CLOSED", open == was_open ? ", no change" : "");

	return reply_state(res, req, addr, addr_len, COAP_RESPONSE_CODE_CHANGED);
}

static int valve_get(struct coap_resource *res, struct coap_packet *req,
		     struct net_sockaddr *addr, net_socklen_t addr_len)
{
	char peer[NET_IPV6_ADDR_LEN];

	LOG_INF("GET /act/valve from %s: %s -> 2.05", peer_str(addr, peer, sizeof(peer)),
		valve_open ? "OPEN" : "CLOSED");

	return reply_state(res, req, addr, addr_len, COAP_RESPONSE_CODE_CONTENT);
}

static const char *const valve_path[] = { "act", "valve", NULL };
COAP_RESOURCE_DEFINE(valve, soilsense, {
	.get = valve_get,
	.put = valve_put,
	.path = valve_path,
});
```
