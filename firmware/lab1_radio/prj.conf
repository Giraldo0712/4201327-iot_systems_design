## CMakeLists.txt
```
cmake_minimum_required(VERSION 3.20.0)
find_package(Zephyr REQUIRED HINTS $ENV{ZEPHYR_BASE})
project(lab1_radio)

target_sources(app PRIVATE src/main.c)
```

## prj.conf
```kconfig
CONFIG_LOG=y
CONFIG_MAIN_STACK_SIZE=4096

# Networking over 802.15.4 (Interface Capability)
CONFIG_NETWORKING=y
CONFIG_NET_L2_OPENTHREAD=y
# Without this every board in the room auto-joins the same default network on
# channel 11 at boot, which also pollutes the Task B energy scan.
CONFIG_OPENTHREAD_MANUAL_START=y
CONFIG_OPENTHREAD_PING_SENDER=y

# Settings backend for the Thread dataset
CONFIG_NVS=y

# OpenThread CLI as "ot <command>"
CONFIG_SHELL=y
CONFIG_NET_SHELL=y
CONFIG_OPENTHREAD_SHELL=y
# "ot dataset set active <hex>" is ~240 characters; the defaults truncate a paste.
CONFIG_SHELL_CMD_BUFF_SIZE=512
CONFIG_SHELL_BACKEND_SERIAL_RX_RING_BUFFER_SIZE=512
```

## src/main.c
```c
#include <zephyr/logging/log.h>

LOG_MODULE_REGISTER(lab1_radio, LOG_LEVEL_INF);

int main(void)
{
	LOG_INF("802.15.4 radio ready. OpenThread commands start with \"ot\".");

	return 0;
}
```
